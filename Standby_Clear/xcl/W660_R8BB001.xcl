-carm

//Тело патча
-Z(CODE)ZAMAIN,CODE,DATA_C,INITTAB=45CBBA00

//Создаем свой пункт
-Z(CODE)PATCH_Standby=45C74378-45C7437B
-Z(CODE)PATCH_StandbyFunc=45C7437C-45C7437F

-Z(CODE)PATCH_SET_TEXT=454AAF6C
