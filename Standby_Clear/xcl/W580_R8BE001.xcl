-carm

//Тело патча
-Z(CODE)ZAMAIN,CODE,DATA_C,INITTAB=45DB11E0

//Создаем свой пункт
-Z(CODE)PATCH_Standby=45BCCBC0-45BCCBC4
-Z(CODE)PATCH_StandbyFunc=45BCCBC4-45BCCBC8

-Z(CODE)PATCH_SET_TEXT=45374998