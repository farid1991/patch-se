-carm

//Тело патча
-Z(CODE)ZAMAIN,CODE,DATA_C,INITTAB=15D80B00

//Создаем свой пункт
-Z(CODE)PATCH_Standby=15B0A430-15B0A433
-Z(CODE)PATCH_StandbyFunc=15B0A434-15B0A437

-Z(CODE)PATCH_SET_TEXT=14305FC4