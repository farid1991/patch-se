-carm

//Тело патча
-Z(CODE)ZAMAIN,CODE,DATA_C,INITTAB=15D04E00

//Создаем свой пункт
-Z(CODE)PATCH_Standby=15B2ADAC-15B2ADAF
-Z(CODE)PATCH_StandbyFunc=15B2ADB0-15B2ADB3

-Z(CODE)PATCH_SET_TEXT=14309EF0