-carm

//Тело патча
-Z(CODE)ZAMAIN,CODE,DATA_C,INITTAB=45C625E0

//Создаем свой пункт
-Z(CODE)PATCH_Standby=45C213CC-45C213CF
-Z(CODE)PATCH_StandbyFunc=45C213D0-45C213D3

-Z(CODE)PATCH_SET_TEXT=454D6E64