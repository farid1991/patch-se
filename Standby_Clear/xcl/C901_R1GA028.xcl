-carm

//Тело патча
-Z(CODE)ZAMAIN,CODE,DATA_C,INITTAB=15D7B380

//Создаем свой пункт
-Z(CODE)PATCH_Standby=15B0FAE0-15B0FAE3
-Z(CODE)PATCH_StandbyFunc=15B0FAE4-15B0FAE7

-Z(CODE)PATCH_SET_TEXT=1434DD20