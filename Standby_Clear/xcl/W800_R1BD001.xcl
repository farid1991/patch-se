-carm

//Тело патча
-Z(CODE)ZAMAIN,CODE,DATA_C,INITTAB=452B5D60

//Создаем свой пункт
-Z(CODE)PATCH_Standby=442AD59C-442AD59F
-Z(CODE)PATCH_StandbyFunc=442AD5A0-442AD5A3

-Z(CODE)PATCH_SET_TEXT=44D3DA58