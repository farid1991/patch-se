//W810_R4EA031
-carm
-Z(CODE)CODE,DATA_C=456E6040
-Z(CODE)PATCH_DB_MANAGEFILE=4524AB6C
-Z(CODE)PATCH_DB_SOFTKEYS_VISIBLE=4524ABC4
//-Z(CODE)PATCH_DB_SOFTKEYS_VISIBLE=4524B42C
//-Z(CODE)PATCH_DB_SOFTKEYS_INVISIBLE=4524B650
