-carm

//Тело патча
-Z(CODE)ZAMAIN,CODE,DATA_C,INITTAB=15DD81C0

//Создаем свой пункт
-Z(CODE)PATCH_Standby=15BF6FA4-15BF6FA7
-Z(CODE)PATCH_StandbyFunc=15BF6FA8-15BF6FAB

-Z(CODE)PATCH_SET_TEXT=140E2304