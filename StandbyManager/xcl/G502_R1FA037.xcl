-carm

//Тело патча
-Z(CODE)ZAMAIN,CODE,DATA_C,INITTAB=120DF510

//Создаем свой пункт
-Z(CODE)PATCH_Standby=11A6EAAC-11A6EAAF
-Z(CODE)PATCH_StandbyFunc=11A6EAB0-11A6EAB3

-Z(CODE)PATCH_SET_TEXT=116B4D98