-carm

//Тело патча
-Z(CODE)ZAMAIN,CODE,DATA_C,INITTAB=45D27040

//Создаем свой пункт
-Z(CODE)PATCH_Standby=45C71264-45C71268
-Z(CODE)PATCH_StandbyFunc=45C71268-45C7126C

//
-Z(CODE)PATCH_SET_TEXT=45473998