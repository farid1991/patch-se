-carm

//Тело патча
-Z(CODE)ZAMAIN,CODE,DATA_C,INITTAB=12792200

//Создаем свой пункт
-Z(CODE)PATCH_Standby=11B847B4-11B847B7
-Z(CODE)PATCH_StandbyFunc=11B847B8-11B847BB

-Z(CODE)PATCH_SET_TEXT=10D8CD0C