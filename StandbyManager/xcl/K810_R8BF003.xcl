-carm

//Тело патча
-Z(CODE)ZAMAIN,CODE,DATA_C,INITTAB=45CEF000

//Создаем свой пункт
-Z(CODE)PATCH_Standby=45C87E8C-45C87E8F
-Z(CODE)PATCH_StandbyFunc=45C87E90-45C87E93

//
-Z(CODE)PATCH_SET_TEXT=4547FED4