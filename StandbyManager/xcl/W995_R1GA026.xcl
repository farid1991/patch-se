-carm

//Тело патча
-Z(CODE)ZAMAIN,CODE,DATA_C,INITTAB=15EDFF00

//Создаем свой пункт
-Z(CODE)PATCH_Standby=15C44528-15C4452B
-Z(CODE)PATCH_StandbyFunc=15C4452C-15C4452F

-Z(CODE)PATCH_SET_TEXT=1434F28C
-Z(CODE)PATCH_SET_TEXT1=143882E4