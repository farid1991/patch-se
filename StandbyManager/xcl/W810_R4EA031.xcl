-carm

//Тело патча
-Z(CODE)ZAMAIN,CODE,DATA_C,INITTAB=456D7FB0

//Создаем свой пункт
-Z(CODE)PATCH_Standby=445725DC-445725DF
-Z(CODE)PATCH_StandbyFunc=445725E0-445725E3

-Z(CODE)PATCH_SET_TEXT=451541C4