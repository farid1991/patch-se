-carm

//Тело патча
-Z(CODE)ZAMAIN,CODE,DATA_C,INITTAB=1268CB00

//Создаем свой пункт
-Z(CODE)PATCH_Standby=11C285F8-11C285FB
-Z(CODE)PATCH_StandbyFunc=11C285FC-11C285FF

-Z(CODE)PATCH_SET_TEXT=10E281D0