-carm
-Z(CODE)CODE,DATA_C,INITTAB=12200160

// m4a
-Z(CODE)PATCH_DB_ITEM1_M4A=11A3C7E8
-Z(CODE)PATCH_DB_ITEM2_M4A=11A3C7F8
		
// mp3
-Z(CODE)PATCH_DB_ITEM1_MP3=11A3CE44
-Z(CODE)PATCH_DB_ITEM2_MP3=11A3CE54

// wav
-Z(CODE)PATCH_DB_ITEM1_WAV=11A3D984
-Z(CODE)PATCH_DB_ITEM2_WAV=11A3D994

// wma
-Z(CODE)PATCH_DB_ITEM1_WMA=11A3DC58
-Z(CODE)PATCH_DB_ITEM2_WMA=11A3DC68

// ra
-Z(CODE)PATCH_DB_ITEM1_RA=11A3D6B0
-Z(CODE)PATCH_DB_ITEM2_RA=11A3D6C0

// aac
-Z(CODE)PATCH_DB_ITEM1_AAC=11A3BC98
-Z(CODE)PATCH_DB_ITEM2_AAC=11A3BCA8