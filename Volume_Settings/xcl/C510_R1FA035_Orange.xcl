-carm
-Z(CODE)PATCH_BODY,CODE,DATA_C,INITTAB=15DD34E0
//-Z(CODE)PATCH_Volume=15C44D60-15C44D63
//-Z(CODE)PATCH_VolumeFunc=15C44D64-15C44D67
//-Z(CODE)PATCH_Volume=15C443E8-15C443EB // Standart
-Z(CODE)PATCH_VolumeFunc=15B99524-15B99527 // Standart