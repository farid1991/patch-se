//S700_R3M008
-carm
-Z(CODE)CODE,DATA_C=44EDF840
-Z(CODE)NEW_ITEM_COUNT=448F02CA
-Z(CODE)KEYPRESS_PATCH=44AA1460
-Z(CODE)KEYSOUND_PATCH=448F0270
-Z(CODE)GUIACTION_PATCH=448F0324
-Z(CODE)GUILIST_PATCH=448F0358
-Z(CODE)MENULIST_PATCH=44AD2098
