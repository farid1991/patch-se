//W350_R11CA002
-carm
-Z(CODE)CODE,DATA_C=21903DB0
-Z(CODE)PATCH_WALKMANKEY1=210549D0
-Z(CODE)PATCH_WALKMANKEY2=21054AA6
-Z(CODE)PATCH_WALKMANKEY3=21054B44
-Z(CODE)PATCH_WALKMANKEY4=21054BAA
-Z(CODE)PATCH_ONOFFKEY=2179EB74
-Z(CODE)PATCH_QUICKACCESS=21068C4C
-Z(CODE)PATCH_SC_SOFTKEYS=2112E96C
