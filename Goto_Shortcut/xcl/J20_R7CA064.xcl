//J20_R7CA064
-carm
-Z(CODE)CODE,DATA_C=15F62180
-Z(CODE)STANDBY_LINK_RIGHT=14B47554
-Z(CODE)STANDBY_SOFTKEY_RIGHT=14B47558

-Z(CODE)STANDBY_SOFTKEY_FIX1=14B473D4
-Z(CODE)STANDBY_SOFTKEY_FIX2=14B473F6
-Z(CODE)STANDBY_SOFTKEY_FIX3=14B47438
-Z(CODE)STANDBY_SOFTKEY_FIX4=14B47452
-Z(CODE)STANDBY_SOFTKEY_FIX5=14B47470
-Z(CODE)STANDBY_SOFTKEY_FIX6=14B474B4
