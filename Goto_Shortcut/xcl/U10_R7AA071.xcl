//U10_R7AA071
-carm
-Z(CODE)CODE,DATA_C=162C2150
-Z(CODE)STANDBY_LINK_RIGHT=145579E0
-Z(CODE)STANDBY_SOFTKEY_FIX1=14557860
-Z(CODE)STANDBY_SOFTKEY_FIX2=145578C6
-Z(CODE)STANDBY_SOFTKEY_FIX3=145578E0
-Z(CODE)STANDBY_SOFTKEY_FIX4=145578FE
-Z(CODE)STANDBY_SOFTKEY_FIX5=14557942
-Z(CODE)STANDBY_SOFTKEY_RIGHT=145579E4
