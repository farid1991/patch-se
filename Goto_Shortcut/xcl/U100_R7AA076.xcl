//U100_R7AA076
-carm
-Z(CODE)CODE,DATA_C=1602D120
-Z(CODE)STANDBY_LINK_RIGHT=14538CFC
-Z(CODE)STANDBY_SOFTKEY_FIX1=14538B7C
-Z(CODE)STANDBY_SOFTKEY_FIX2=14538BE2
-Z(CODE)STANDBY_SOFTKEY_FIX3=14538BFC
-Z(CODE)STANDBY_SOFTKEY_FIX4=14538C1A
-Z(CODE)STANDBY_SOFTKEY_FIX5=14538C5E
-Z(CODE)STANDBY_SOFTKEY_RIGHT=14538D00
