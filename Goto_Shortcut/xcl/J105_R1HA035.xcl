-carm

-Z(CODE)STANDBY_SOFTKEY_LEFT=14EE4F70
-Z(CODE)STANDBY_SOFTKEY_RIGHT=14EE4DA6
-Z(CODE)STANDBY_LINK_LEFT=14EE4F74-14EE4F77
-Z(CODE)STANDBY_LINK_RIGHT=14EE4F80-14EE4F83

-Z(CODE)ZAMAIN,CODE,DATA_C,INITTAB=15C31B60
