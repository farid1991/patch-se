//W810_R4EA031
-carm
-Z(CODE)CODE,DATA_C=45704DC0
-Z(CODE)PATCH_TIMER_SET=452AB328
-Z(CODE)PATCH_TIMER_KILL=452AB3C8
-Z(CODE)PATCH_SLEEPMODE_ONCREATE=452ABC28
-Z(CODE)PATCH_SLEEPMODE_ONCLOSE=452ABC2C
-Z(CODE)PATCH_SLEEPMODE_ONREDRAW=452ABC30
-Z(CODE)PATCH_SLEEPMODE_BACKLIGHT=452AB9BC
