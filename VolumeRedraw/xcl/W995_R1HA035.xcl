-carm

-Z(CODE)FREE_SPACE,CODE,DATA_C,INITTAB=15E8AA10

-Z(CODE)PATCH_VOLUMEONPAGENTER=15D5F0C8
-Z(CODE)PATCH_VOLUMEONPAGEXIT=15D5F0D0

-Z(CODE)PATCH_VOLUMEONCREATE=14F98568
-Z(CODE)PATCH_VOLUMEONREDRAW=14F98570
-Z(CODE)PATCH_VOLUMEONDESTROY=14F9856C







