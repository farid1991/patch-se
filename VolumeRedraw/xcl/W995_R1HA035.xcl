//W995_R1HA035
-carm
-Z(CODE)CODE,DATA_C=15E8DAF0
-Z(CODE)PATCH_VOLUMEONCREATE=14F98568
-Z(CODE)PATCH_VOLUMEONCLOSE=14F9856C
-Z(CODE)PATCH_VOLUMEONREDRAW=14F98570
-Z(CODE)PATCH_VOLUMEONPAGENTER=15D5F0C8
