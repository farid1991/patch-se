-carm

-Z(CODE)FREE_SPACE,CODE,DATA_C,INITTAB=1219AF70 //1219C0C0

-Z(CODE)PATCH_VOLUMEONPAGENTER=11B846F0
-Z(CODE)PATCH_VOLUMEONPAGEXIT=11B846F8

-Z(CODE)PATCH_VOLUMEONCREATE=116DF990
-Z(CODE)PATCH_VOLUMEONCLOSE=116DF990
-Z(CODE)PATCH_VOLUMEONREDRAW=116DF998
