//W980_R3EG004
-carm
-Z(CODE)CODE,DATA_C=127C9200
-Z(CODE)PATCH_VOLUMEONPAGENTER=11F3B278
-Z(CODE)PATCH_VOLUMEONPAGEXIT=11F3B280
-Z(CODE)PATCH_VOLUMEONCREATE=11AC6530
-Z(CODE)PATCH_VOLUMEONCLOSE=11AC6534
-Z(CODE)PATCH_VOLUMEONREDRAW=11AC6538
