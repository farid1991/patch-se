//C903_R1GA028
-carm
-Z(CODE)CODE,DATA_C=15E3F470
-Z(CODE)PATCH_VOLUMEONCREATE=14F73B38
-Z(CODE)PATCH_VOLUMEONCLOSE=14F73B3C
-Z(CODE)PATCH_VOLUMEONREDRAW=14F73B40
-Z(CODE)PATCH_VOLUMEONPAGENTER=15CBA200
