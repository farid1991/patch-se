//W910_R1FA037
-carm
-Z(CODE)CODE,DATA_C=12240000
-Z(CODE)PATCH_VOLUMEONPAGENTER=11B5B5C8
-Z(CODE)PATCH_VOLUMEONCREATE=116AF494
-Z(CODE)PATCH_VOLUMEONCLOSE=116AF498
-Z(CODE)PATCH_VOLUMEONREDRAW=116AF49C
