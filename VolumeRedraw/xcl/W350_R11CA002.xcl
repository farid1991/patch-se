//W350_R11CA002
-carm
-Z(CODE)CODE,DATA_C=219003D0
-Z(CODE)PATCH_VOLUMEONPAGENTER=2179E57C
-Z(CODE)PATCH_VOLUMEONCREATE=21062174
-Z(CODE)PATCH_VOLUMEONCLOSE=21062178
-Z(CODE)PATCH_VOLUMEONREDRAW=2106217C
