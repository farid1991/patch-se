//W508_R1FA035
-carm
-Z(CODE)CODE,DATA_C=15CD0000
-Z(CODE)PATCH_VOLUMEONPAGENTER=15B6F934
-Z(CODE)PATCH_VOLUMEONCREATE=14EF3BC8
-Z(CODE)PATCH_VOLUMEONCLOSE=14EF3BCC
-Z(CODE)PATCH_VOLUMEONREDRAW=14EF3BD0