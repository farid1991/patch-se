-carm

-Z(CODE)FREE_SPACE,CODE,DATA_C,INITTAB=15E3C3E0

-Z(CODE)PATCH_VOLUMEONPAGENTER=15D54B44
-Z(CODE)PATCH_VOLUMEONPAGEXIT=15D54B4C

-Z(CODE)PATCH_VOLUMEONCREATE=14F95840
-Z(CODE)PATCH_VOLUMEONREDRAW=14F95848
-Z(CODE)PATCH_VOLUMEONDESTROY=14F95844







