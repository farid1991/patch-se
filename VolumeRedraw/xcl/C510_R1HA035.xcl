-carm

-Z(CODE)CODE,DATA_C,INITTAB=15D3B3D0

-Z(CODE)PATCH_VOLUMEONPAGENTER=15C3A608
-Z(CODE)PATCH_VOLUMEONPAGEXIT=15C3A610

-Z(CODE)PATCH_VOLUMEONCREATE=14ED7504
-Z(CODE)PATCH_VOLUMEONCLOSE=14ED7508
-Z(CODE)PATCH_VOLUMEONREDRAW=14ED750C
