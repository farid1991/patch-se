//K600_R2BB001
-carm
-Z(CODE)CODE,DATA_C=21474320
-Z(CODE)PATCH_VOLUMEONPAGENTER=20F8A7E0
-Z(CODE)PATCH_VOLUMEONCREATE=2026B4A8
-Z(CODE)PATCH_VOLUMEONCLOSE=2026B4AC
-Z(CODE)PATCH_VOLUMEONREDRAW=2026B4B0
