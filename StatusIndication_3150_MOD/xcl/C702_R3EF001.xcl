-carm

//Тело патча
-Z(CODE)ZAMAIN,CODE,DATA_C,DATA_Z,CONFIG_C,INITTAB=127D0000-127D7800

-Z(CODE)PATCH_DRAWSTATUS=117EAE44
-Z(CODE)PATCH_DRAWDISPLAY=10DFD440
-Z(CODE)PATCH_DRAWSOFT=10882C9C

-Z(CODE)PATCH_CREATEDISPLAY=10DFD438
-Z(CODE)PATCH_CLOSEDISPLAY=10DFD43C

-Z(CODE)PATCH_ONKEYMAININPUT=10DFB164

-Z(CODE)PATCH_CALLOFF_CLEAR=10DFFB0C

-Z(CODE)PATCH_SET_TRAY_ICON=117FA2C8-117FA2D3
-Z(CODE)PATCH_SET_TRAY_ICON_2=117FA2D4-117FA2DF
