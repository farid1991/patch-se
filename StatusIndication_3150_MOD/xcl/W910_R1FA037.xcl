-carm

//Тело патча
-Z(CODE)ZAMAIN,CODE,DATA_C,DATA_Z,CONFIG_C,INITTAB=12190000-12197800

-Z(CODE)PATCH_DRAWSTATUS=116715BC
-Z(CODE)PATCH_DRAWDISPLAY=1168126C
-Z(CODE)PATCH_DRAWSOFT=1168F884

-Z(CODE)PATCH_CREATEDISPLAY=11681264
-Z(CODE)PATCH_CLOSEDISPLAY=11681268

-Z(CODE)PATCH_ONKEYMAININPUT=1169B56C

-Z(CODE)PATCH_CALLOFF_CLEAR=115DF79C

-Z(CODE)PATCH_SET_TRAY_ICON=116660A0-116660AB
-Z(CODE)PATCH_SET_TRAY_ICON_2=116660AC-116660B7
