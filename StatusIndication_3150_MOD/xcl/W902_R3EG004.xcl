-carm

//Тело патча
-Z(CODE)ZAMAIN,CODE,DATA_C,DATA_Z,CONFIG_C,INITTAB=127D7170-127DE970

-Z(CODE)PATCH_DRAWSTATUS=11792B0C
-Z(CODE)PATCH_DRAWDISPLAY=10D94604
-Z(CODE)PATCH_DRAWSOFT=10815370

-Z(CODE)PATCH_CREATEDISPLAY=10D945FC
-Z(CODE)PATCH_CLOSEDISPLAY=10D94600

-Z(CODE)PATCH_ONKEYMAININPUT=10D92328

-Z(CODE)PATCH_CALLOFF_CLEAR=10D96CCC

-Z(CODE)PATCH_SET_TRAY_ICON=117A1F7C-117A1F87
-Z(CODE)PATCH_SET_TRAY_ICON_2=117A1F88-117A1F93
