-carm

//Тело патча
-Z(CODE)ZAMAIN,CODE,DATA_C,DATA_Z,CONFIG_C,INITTAB=12220000

-Z(CODE)PATCH_DRAWSTATUS=116E41CC
-Z(CODE)PATCH_DRAWDISPLAY=116F3E7C
-Z(CODE)PATCH_DRAWSOFT=11702490

-Z(CODE)PATCH_CREATEDISPLAY=116F3E74
-Z(CODE)PATCH_CLOSEDISPLAY=116F3E78

-Z(CODE)PATCH_ONKEYMAININPUT=1170E190

-Z(CODE)PATCH_CALLOFF_CLEAR=11652748

-Z(CODE)PATCH_SET_TRAY_ICON=116D8CB0-116D8CBB
-Z(CODE)PATCH_SET_TRAY_ICON_2=116D8CBC-116D8CC7
