-carm

//Тело патча
-Z(CODE)ZAMAIN,CODE,DATA_C,DATA_Z,CONFIG_C,INITTAB=126D3300

-Z(CODE)PATCH_DRAWSTATUS=117F4290
-Z(CODE)PATCH_DRAWDISPLAY=10DF9034
-Z(CODE)PATCH_DRAWSOFT=10874D18

-Z(CODE)PATCH_CREATEDISPLAY=10DF902C
-Z(CODE)PATCH_CLOSEDISPLAY=10DF9030

-Z(CODE)PATCH_ONKEYMAININPUT=10DF6D58

-Z(CODE)PATCH_CALLOFF_CLEAR=10DFB6F4

-Z(CODE)PATCH_SET_TRAY_ICON=11803700-1180370B
-Z(CODE)PATCH_SET_TRAY_ICON_2=1180370C-11803717
