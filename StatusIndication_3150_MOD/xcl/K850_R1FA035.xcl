-carm

//Тело патча
-Z(CODE)ZAMAIN,CODE,DATA_C,DATA_Z,CONFIG_C,INITTAB=12230000-12237800

-Z(CODE)PATCH_DRAWSTATUS=11658B1C
-Z(CODE)PATCH_DRAWDISPLAY=116687CC
-Z(CODE)PATCH_DRAWSOFT=11676EEC

-Z(CODE)PATCH_CREATEDISPLAY=116687C4
-Z(CODE)PATCH_CLOSEDISPLAY=116687C8

-Z(CODE)PATCH_ONKEYMAININPUT=11682BDC

-Z(CODE)PATCH_CALLOFF_CLEAR=115C6E54

-Z(CODE)PATCH_SET_TRAY_ICON=1164D564-1164D56F
-Z(CODE)PATCH_SET_TRAY_ICON_2=1164D570-1164D57B
