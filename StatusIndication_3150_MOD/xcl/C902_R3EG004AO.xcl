-carm

//Тело патча
-Z(CODE)ZAMAIN,CODE,DATA_C,DATA_Z,CONFIG_C,INITTAB=127E2790

-Z(CODE)PATCH_DRAWSTATUS=11770B98
-Z(CODE)PATCH_DRAWDISPLAY=10D703A0
-Z(CODE)PATCH_DRAWSOFT=107F3020

-Z(CODE)PATCH_CREATEDISPLAY=10D70398
-Z(CODE)PATCH_CLOSEDISPLAY=10D7039C

-Z(CODE)PATCH_ONKEYMAININPUT=10D6E0C4

-Z(CODE)PATCH_CALLOFF_CLEAR=10D72A6C

-Z(CODE)PATCH_SET_TRAY_ICON=11780008-11780013
-Z(CODE)PATCH_SET_TRAY_ICON_2=11780014-1178001F
