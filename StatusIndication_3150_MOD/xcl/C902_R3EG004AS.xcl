-carm

//Тело патча
-Z(CODE)ZAMAIN,CODE,DATA_C,DATA_Z,CONFIG_C,INITTAB=1268B000

-Z(CODE)PATCH_DRAWSTATUS=1175EEE8
-Z(CODE)PATCH_DRAWDISPLAY=10D703C0
-Z(CODE)PATCH_DRAWSOFT=107F3040

-Z(CODE)PATCH_CREATEDISPLAY=10D703B8
-Z(CODE)PATCH_CLOSEDISPLAY=10D703BC

-Z(CODE)PATCH_ONKEYMAININPUT=10D6E0E4

-Z(CODE)PATCH_CALLOFF_CLEAR=10D72A8C

-Z(CODE)PATCH_SET_TRAY_ICON=1176E358-1176E363
-Z(CODE)PATCH_SET_TRAY_ICON_2=1176E364-1176E36F
