-carm

//Тело патча
//-Z(CODE)ZAMAIN,CODE,DATA_C,DATA_Z,CONFIG_C,INITTAB=1278D460-12794C60
-Z(CODE)ZAMAIN,CODE,DATA_C,DATA_Z,CONFIG_C,INITTAB=12794D50-1279C550

-Z(CODE)PATCH_DRAWSTATUS=1181843C
-Z(CODE)PATCH_DRAWDISPLAY=10E27754
-Z(CODE)PATCH_DRAWSOFT=108ABE20

-Z(CODE)PATCH_CREATEDISPLAY=10E2774C
-Z(CODE)PATCH_CLOSEDISPLAY=10E27750

-Z(CODE)PATCH_ONKEYMAININPUT=10E25468

-Z(CODE)PATCH_CALLOFF_CLEAR=10E29E14

-Z(CODE)PATCH_SET_TRAY_ICON=118278C0-118278CB
-Z(CODE)PATCH_SET_TRAY_ICON_2=118278CC-118278D7
