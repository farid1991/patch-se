-carm

//Тело патча
-Z(CODE)ZAMAIN,CODE,DATA_C,DATA_Z,CONFIG_C,INITTAB=126D8350

-Z(CODE)PATCH_DRAWSTATUS=11770D54
-Z(CODE)PATCH_DRAWDISPLAY=10D8C290
-Z(CODE)PATCH_DRAWSOFT=1080D330

-Z(CODE)PATCH_CREATEDISPLAY=10D8C288
-Z(CODE)PATCH_CLOSEDISPLAY=10D8C28C

-Z(CODE)PATCH_ONKEYMAININPUT=10D89FB4

-Z(CODE)PATCH_CALLOFF_CLEAR=10D8E950

-Z(CODE)PATCH_SET_TRAY_ICON=117801C4-117801CF
-Z(CODE)PATCH_SET_TRAY_ICON_2=117801D0-117801DB
