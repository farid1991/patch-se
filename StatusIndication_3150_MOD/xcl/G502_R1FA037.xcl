-carm

//Тело патча
-Z(CODE)ZAMAIN,CODE,DATA_C,DATA_Z,CONFIG_C,INITTAB=120E0A30

-Z(CODE)PATCH_DRAWSTATUS=116A211C
-Z(CODE)PATCH_DRAWDISPLAY=116B1DCC
-Z(CODE)PATCH_DRAWSOFT=116C03E0

-Z(CODE)PATCH_CREATEDISPLAY=116B1DC4
-Z(CODE)PATCH_CLOSEDISPLAY=116B1DC8

-Z(CODE)PATCH_ONKEYMAININPUT=116CC0C8

-Z(CODE)PATCH_CALLOFF_CLEAR=1161069C

-Z(CODE)PATCH_SET_TRAY_ICON=11696BF0-11696BFB
-Z(CODE)PATCH_SET_TRAY_ICON_2=11696BFC-11696C07
