-carm
-Z(CODE)PATCH_BODY,CODE,DATA_C,DATA_Z,DATA_I,DATA_ID,CONFIG_C,INITTAB=12205CA0

-Z(CODE)PATCH_REDRAW_HOOK=115FE084
-Z(CODE)PATCH_ONCREATE_HOOK=115FE07C
-Z(CODE)PATCH_ONDESTROY_HOOK=115FE080

-Z(CODE)PATCH_UPDATE_ORIENTATION_HOOK=116461E0

-Z(CODE)PATCH_UPDATE_SHUFFLE_HOOK=115F9350
-Z(CODE)PATCH_NEW_LIST=115F9DF0
-Z(CODE)PATCH_StereoWidening=115FBB10

-Z(CODE)MUSIC_APP_ON_ENTER_PAGE_HOOK=11BB14A8
-Z(CODE)PATCH_ON_NEW_TRACK_HOOK=11BB1450
-Z(CODE)PATCH_UI_MEDIAPLAYER_AUDIO_PLAYING_TIME_EVENT_HOOK=11BB1438
-Z(CODE)PATCH_UI_MEDIAPLAYER_CREATED_EVENT_HOOK=11BB1418

-Z(CODE)PATCH_START_TIMER=10917C20
-Z(CODE)PATCH_START_TIMER_2=10917AF0
-Z(CODE)PATCH_STOP_TIMER=10917B44
-Z(CODE)PATCH_STOP_TIMER_2=10917CD4


-Z(CODE)PATCH_Walkman_GUI=115FEB78
