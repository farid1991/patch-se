-carm
-Z(CODE)PATCH_BODY,CODE,DATA_C,DATA_Z,DATA_I,DATA_ID,CONFIG_C,INITTAB=15D2F710
-Z(CODE)PATCH_REDRAW_HOOK=14CD5FF4
-Z(CODE)PATCH_ONCREATE_HOOK=14CD5FEC
-Z(CODE)PATCH_ONDESTROY_HOOK=14CD5FF0

-Z(CODE)PATCH_UPDATE_ORIENTATION_HOOK=14129788
-Z(CODE)PATCH_UPDATE_ORIENTATION_HOOK_2=14129764
-Z(CODE)PATCH_UPDATE_ORIENTATION_HOOK_3=14129778


-Z(CODE)PATCH_START_TIMER=1024BFD4
-Z(CODE)PATCH_START_TIMER_2=100BC4CC
-Z(CODE)PATCH_STOP_TIMER=10269DBC
-Z(CODE)PATCH_STOP_TIMER_2=100BC0F0


-Z(CODE)PATCH_Walkman_GUI=14D445B4
-Z(CODE)PATCH_NEW_LIST=14F14D6C
-Z(CODE)PATCH_StereoWidening=1534888C
-Z(CODE)PATCH_UPDATE_SHUFFLE_HOOK=14E1F9F8

-Z(CODE)PATCH_ON_NEW_TRACK_HOOK=1595BC48
-Z(CODE)PATCH_UI_MEDIAPLAYER_AUDIO_PLAYING_TIME_EVENT_HOOK=1595BC30
-Z(CODE)PATCH_UI_MEDIAPLAYER_CREATED_EVENT_HOOK=1595BC08
-Z(CODE)MUSIC_APP_ON_ENTER_PAGE_HOOK=1595BCE0






