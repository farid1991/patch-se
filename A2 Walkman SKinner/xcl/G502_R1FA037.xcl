-carm
-Z(CODE)PATCH_BODY,CODE,DATA_C,DATA_Z,DATA_I,DATA_ID,CONFIG_C,INITTAB=121A0000

-Z(CODE)PATCH_ONCREATE_HOOK=115BD3C8
-Z(CODE)PATCH_ONDESTROY_HOOK=115BD3CC
-Z(CODE)PATCH_REDRAW_HOOK=115BD3D0

-Z(CODE)PATCH_UPDATE_ORIENTATION_HOOK=11604114

-Z(CODE)PATCH_UPDATE_LOOP_HOOK=115B8A90
-Z(CODE)PATCH_UPDATE_SHUFFLE_HOOK=115B8A64

-Z(CODE)PATCH_NEW_LIST=115B94F0
-Z(CODE)PATCH_StereoWidening=115BAEB4

-Z(CODE)PATCH_UI_MEDIAPLAYER_CREATED_EVENT_HOOK=11B65210
-Z(CODE)PATCH_UI_MEDIAPLAYER_AUDIO_PLAYING_TIME_EVENT_HOOK=11B65230
-Z(CODE)PATCH_ON_NEW_TRACK_HOOK=11B65248
-Z(CODE)MUSIC_APP_ON_ENTER_PAGE_HOOK=11B652A0

-Z(CODE)PATCH_START_TIMER=10900120
-Z(CODE)PATCH_START_TIMER_2=108FFFF0
-Z(CODE)PATCH_STOP_TIMER=10900044
-Z(CODE)PATCH_STOP_TIMER_2=109001D4

-Z(CODE)PATCH_Walkman_GUI=115BDEC4

-Z(CODE)PATCH_REDRAW_PLAYQUEUE=115BDC8C

-Z(CODE)PATCH_Delete_WALKMANFunction_HOOK=115B84C8