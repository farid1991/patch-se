//G502_R1FA037
-carm
-Z(CODE)CODE,DATA_C,INITTAB=12183FA0
-Z(CODE)BR_CREATE=11B751A0 //evtlst_Brightness_ChangeBrightness_ENTER
-Z(CODE)BR_CLOSE=11B751A8 //evtlst_Brightness_ChangeBrightness_EXIT
-Z(CODE)ITEM_TEXT=116251A0
-Z(CODE)BR_1=116DB0B8
-Z(CODE)BR_2=116DB0BC