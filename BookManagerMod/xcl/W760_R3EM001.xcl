//W760_R3EM001
-carm
-Z(CODE)CODE,DATA_C=128159A0

-Z(CODE)TAB_ICON_1=10BD1084
-Z(CODE)TAB_ICON_2=10BD10B8

-Z(CODE)TAB_FOCUS=10BD04FC
-Z(CODE)GUI_CREATE=10BD0764
-Z(CODE)BOOK_CLOSE=10BD0218

-Z(CODE)EVENTS=10BD669C
-Z(CODE)INTERNET=10BD06A4
-Z(CODE)SHORTCURTS=10BD06C0
-Z(CODE)ACTIVETASKS=10BD06E4
