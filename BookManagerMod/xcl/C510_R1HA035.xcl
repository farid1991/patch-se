-carm

-Z(CODE)CODE,DATA_C,INITTAB=15DD8A00

-Z(CODE)TAB_ICON_1=144B21C0
-Z(CODE)TAB_ICON_2=144B21F0
//-Z(CODE)TAB_ICON_3=144AC408

-Z(CODE)TAB_FOCUS=14E05988
-Z(CODE)GUI_CREATE=14E057B0
-Z(CODE)BOOK_CLOSE=14D5F2D0

-Z(CODE)EVENTS=14C8278C
-Z(CODE)INTERNET=14C826FC
-Z(CODE)SHORTCURTS=14C82718
-Z(CODE)ACTIVETASKS=14C8273C