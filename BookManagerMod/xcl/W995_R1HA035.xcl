//W995_R1HA035
-carm
-Z(CODE)CODE,DATA_C=15F03D00

-Z(CODE)TAB_ICON_1=14517624
-Z(CODE)TAB_ICON_2=14517654

-Z(CODE)TAB_FOCUS=150AE4E0
-Z(CODE)GUI_CREATE=150AE300
-Z(CODE)BOOK_CLOSE=14EA0D90

-Z(CODE)EVENTS=150AE1A0
-Z(CODE)INTERNET=1402BCD0
-Z(CODE)SHORTCURTS=1402BCEC
-Z(CODE)ACTIVETASKS=1402BD10
