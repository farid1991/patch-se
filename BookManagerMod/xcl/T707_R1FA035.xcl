//T707_R1FA035
-carm
-Z(CODE)CODE,DATA_C=15C909E0

-Z(CODE)TAB_ICON_1=1457D0B4
-Z(CODE)TAB_ICON_2=1457D0EC
-Z(CODE)TAB_ICON_3=1457D0AC
-Z(CODE)TAB_FOCUS=14F8733C
-Z(CODE)GUI_CREATE=14F87200
-Z(CODE)BOOK_CLOSE=14F8E3E8

-Z(CODE)EVENTS=14F86F74
-Z(CODE)INTERNET=1402303C
-Z(CODE)SHORTCURTS=14023058
-Z(CODE)ACTIVETASKS=1402307C
