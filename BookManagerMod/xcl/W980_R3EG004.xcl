//W980_R3EG004
-carm
-Z(CODE)CODE,DATA_C=127CD7E0

-Z(CODE)TAB_ICON_1=10B3185C
-Z(CODE)TAB_ICON_2=10B31890

-Z(CODE)TAB_FOCUS=10B30CCC
-Z(CODE)GUI_CREATE=10B30F34
-Z(CODE)BOOK_CLOSE=10B309E8

-Z(CODE)EVENTS=10B3711C
-Z(CODE)INTERNET=10B30E74
-Z(CODE)SHORTCURTS=10B30E90
-Z(CODE)ACTIVETASKS=10B30EB4
