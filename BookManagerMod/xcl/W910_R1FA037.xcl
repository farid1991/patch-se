//W910_R1FA037
-carm
-Z(CODE)CODE,DATA_C=12240900

-Z(CODE)TAB_ICON_1=116A02BC
-Z(CODE)TAB_ICON_2=116A02F4

-Z(CODE)TAB_FOCUS=1169F4AC
-Z(CODE)GUI_CREATE=1169F730
-Z(CODE)BOOK_CLOSE=1169F1D0

-Z(CODE)EVENTS=116A56E8
-Z(CODE)INTERNET=1169F678
-Z(CODE)SHORTCURTS=1169F694
-Z(CODE)ACTIVETASKS=1169F6B8
