//W810_R4EA031
-carm
-Z(CODE)CODE,DATA_C=457F0080

-Z(CODE)ICON_TAB_ACTIVETASKS=44563FB8
-Z(CODE)ICON_TAB_INTERNET=4563E58C
-Z(CODE)TAB_FOCUS=4563E41C
-Z(CODE)GUI_CREATE=4563E3E4
-Z(CODE)BOOK_CLOSE=4563E6B4

-Z(CODE)TAB_EVENTS=4563FB6C
-Z(CODE)TAB_INTERNET=4563E27C
-Z(CODE)TAB_ACTIVETASKS=4563E2AC
