-carm
-Z(CODE)CODE,DATA_C=15DDF3B0

-Z(CODE)TAB_ICON_1=144AC410
-Z(CODE)TAB_ICON_2=144AC448
-Z(CODE)TAB_ICON_3=144AC408
-Z(CODE)TAB_FOCUS=14E726DC
-Z(CODE)GUI_CREATE=14E72504
-Z(CODE)BOOK_CLOSE=14DCCE38

-Z(CODE)EVENTS=14CF0E04
-Z(CODE)INTERNET=14CF0D74
-Z(CODE)SHORTCURTS=14CF0D90
-Z(CODE)ACTIVETASKS=14CF0DB4