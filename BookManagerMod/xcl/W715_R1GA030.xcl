//W715_R1GA030
-carm
-Z(CODE)CODE,DATA_C=15DE2BA0

-Z(CODE)TAB_ICON_1=144BA224
-Z(CODE)TAB_ICON_2=144BA25C

-Z(CODE)TAB_FOCUS=14ECA020
-Z(CODE)GUI_CREATE=14EC9E48
-Z(CODE)BOOK_CLOSE=14E218F8

-Z(CODE)EVENTS=14D428A8
-Z(CODE)INTERNET=14D42818
-Z(CODE)SHORTCURTS=14D42834
-Z(CODE)ACTIVETASKS=14D42858
