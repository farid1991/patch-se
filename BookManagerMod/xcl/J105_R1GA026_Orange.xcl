//J105_R1GA026_Orange
-carm
-Z(CODE)CODE,DATA_C=15CC8590

-Z(CODE)TAB_ICON_1=1457F0F0
-Z(CODE)TAB_ICON_2=1457F128
-Z(CODE)TAB_ICON_3=1457F0E8
-Z(CODE)TAB_FOCUS=14FEE5C0
-Z(CODE)GUI_CREATE=14FEE484
-Z(CODE)BOOK_CLOSE=14FF568C

-Z(CODE)EVENTS=14FEE1F8
-Z(CODE)INTERNET=140234B8
-Z(CODE)SHORTCURTS=140234D4
-Z(CODE)ACTIVETASKS=140234F8
