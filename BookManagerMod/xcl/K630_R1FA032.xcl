//K630_R1FA032
-carm
-Z(CODE)CODE,DATA_C=12018060

-Z(CODE)TAB_ICON_1=11664B18
-Z(CODE)TAB_ICON_2=11664B50
-Z(CODE)TAB_ICON_3=11664B10 

-Z(CODE)TAB_FOCUS=11663D08
-Z(CODE)GUI_CREATE=11663F8C
-Z(CODE)BOOK_CLOSE=11663A2C

-Z(CODE)EVENTS=11669F44
-Z(CODE)INTERNET=11663ED4
-Z(CODE)SHORTCURTS=11663EF0
-Z(CODE)ACTIVETASKS=11663F14