//W508_R1FA035
-carm
-Z(CODE)CODE,DATA_C=15CD2E70

-Z(CODE)TAB_ICON_1=14581870
-Z(CODE)TAB_ICON_2=145818A8
-Z(CODE)TAB_ICON_3=14581868
-Z(CODE)TAB_FOCUS=14FB3638
-Z(CODE)GUI_CREATE=14FB34FC
-Z(CODE)BOOK_CLOSE=14FBA6DC

-Z(CODE)EVENTS=14FB3270
-Z(CODE)INTERNET=140238F0
-Z(CODE)SHORTCURTS=1402390C
-Z(CODE)ACTIVETASKS=14023930
