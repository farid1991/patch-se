//W902_R3EG004
-carm
-Z(CODE)CODE,DATA_C=1282C460

-Z(CODE)TAB_ICON_1=10B3BD94
-Z(CODE)TAB_ICON_2=10B3BDC8

-Z(CODE)TAB_FOCUS=10B3B204
-Z(CODE)GUI_CREATE=10B3B46C
-Z(CODE)BOOK_CLOSE=10B3AF20

-Z(CODE)EVENTS=10B413A4
-Z(CODE)INTERNET=10B3B3AC
-Z(CODE)SHORTCURTS=10B3B3C8
-Z(CODE)ACTIVETASKS=10B3B3EC
