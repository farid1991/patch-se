-carm
-Z(CODE)CODE,DATA_C=121B1200

-Z(CODE)TAB_ICON_1=116D0E30
-Z(CODE)TAB_ICON_2=116D0E68
-Z(CODE)TAB_ICON_3=116D0E28

-Z(CODE)TAB_FOCUS=116D0018
-Z(CODE)GUI_CREATE=116D029C // fixed
-Z(CODE)BOOK_CLOSE=116CFD3C // fixed

-Z(CODE)EVENTS=116D625C
-Z(CODE)INTERNET=116D01E4
-Z(CODE)SHORTCURTS=116D0200
-Z(CODE)ACTIVETASKS=116D0224