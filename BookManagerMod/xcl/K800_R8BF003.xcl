-carm
-Z(CODE)CODE,DATA_C,DATA_I,DATA_ID,INITTAB=121B1200

-Z(CODE)TAB_ICON_1=116D0E30
-Z(CODE)TAB_ICON_2=116D0E68
-Z(CODE)TAB_ICON_3=116D0E28

-Z(CODE)TAB_FOCUS=45489768   // ported
-Z(CODE)GUI_CREATE=454896F8  // ported
-Z(CODE)BOOK_CLOSE=45489974  // ported

-Z(CODE)EVENTS=4548AF98      // ported
-Z(CODE)INTERNET=454893DA    // ported
-Z(CODE)SHORTCURTS=454893E4  // ported
-Z(CODE)ACTIVETASKS=454893EE // ported