-carm
-Z(CODE)CODE,DATA_C=15EBC2E0
//-Z(CODE)PATCH_Volume=15C44D60-15C44D63
//-Z(CODE)PATCH_VolumeFunc=15C44D64-15C44D67
//-Z(CODE)PATCH_Volume=15C443E8-15C443EB // Standart
-Z(CODE)PATCH_VolumeFunc=15C443EC-15C443EF // Standart