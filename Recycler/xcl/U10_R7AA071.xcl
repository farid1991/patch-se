//U10_R7AA071
-carm
-Z(CODE)CODE,DATA_C=162C3AA0
-Z(CODE)SET_KEY_FILE_1=151996BC //pg_Generic_Delete__0xF
-Z(CODE)SET_KEY_FILE_2=1513A734 //Mark Delete
-Z(CODE)SET_KEY_PATH=15375FE8   //pg_Directory_Delete__0xF
-Z(CODE)FILE_DELETE=145A5804    //RESPONSE_DATABROWSER_DELETE
