//W508_R1FA035
-carm
-Z(CODE)CODE,DATA_C=15CD5850
-Z(CODE)PATCH_StatusRow_OnRedraw=141AA1B0
-Z(CODE)PATCH_ObEx_ReceiveFile=158AF480
-Z(CODE)PATCH_ObEx_SendFile=158AF7C8
-Z(CODE)PATCH_ObEx_SendMultipleFiles=158AF800
-Z(CODE)PATCH_ObEx_FileSent=158AF848
