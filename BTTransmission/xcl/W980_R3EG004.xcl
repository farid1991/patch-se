//W980_R3EG004
-carm
-Z(CODE)CODE,DATA_C=127BC0A0
-Z(CODE)PATCH_StatusRow_OnRedraw=11780104
-Z(CODE)PATCH_ObEx_ReceiveFile=11B179D8
-Z(CODE)PATCH_ObEx_SendFile=11B17D14
-Z(CODE)PATCH_ObEx_SendMultipleFiles=11B17D4C
-Z(CODE)PATCH_ObEx_FileSent=11B17DA0
