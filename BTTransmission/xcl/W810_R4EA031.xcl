//W810_R4EA031
-carm
-Z(CODE)CODE,DATA_C=457B1950
-Z(CODE)PATCH_StatusRow_OnRedraw=45308B28
-Z(CODE)PATCH_ObEx_ReceiveFile=444DA620
-Z(CODE)PATCH_ObEx_SendFile=444DA9B0
-Z(CODE)PATCH_ObEx_SendMultipleFiles=444DAA34
-Z(CODE)PATCH_ObEx_FileSent=444DAA88
