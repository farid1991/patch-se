//G502_R1FA037
-carm

-Z(CODE)CODE,DATA_C=12103da0
-Z(CODE)PATCH_GUIObject_SetFocus=116A6BF0
-Z(CODE)PATCH_BookObj_SetFocus=11603C94
-Z(CODE)PATCH_SCREENSAVER=11B84358

-Z(CODE)PATCH_Backlight=11A6EAA4-11A6EAA7
-Z(CODE)PATCH_RUN_Backlight=11A6EAA8-11A6EAAB