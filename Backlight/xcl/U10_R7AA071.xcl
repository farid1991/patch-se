//U10_R7AA071
-carm

-Z(CODE)CODE,DATA_C=162C4F90
-Z(CODE)PATCH_GUIObject_SetFocus=146C56C4
-Z(CODE)PATCH_BookObj_SetFocus=146613E0
-Z(CODE)PATCH_SCREENSAVER=15B6019C

-Z(CODE)PATCH_Backlight=15B6A5AC-15B6A5AF
-Z(CODE)PATCH_RUN_Backlight=15B6A5B0-15B6A5B3
