//W660_R8BB001
-carm

-Z(CODE)ZAMAIN,CODE,DATA_C,INITTAB=45C6BD50
-Z(CODE)PATCH_GUI=454C7236
-Z(CODE)PATCH_SCREENSAVER=45C23700

-Z(CODE)PATCH_Backlight=45C21004-45C21007
-Z(CODE)PATCH_RUN_Backlight=45C21008-45C2100B