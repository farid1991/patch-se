//C510_R1HA035
-carm

-Z(CODE)CODE,DATA_C=15D1EAF0
-Z(CODE)PATCH_GUIObject_SetFocus=144CB994
-Z(CODE)PATCH_BookObj_SetFocus=144CB1A0
-Z(CODE)PATCH_SCREENSAVER=158D3808

-Z(CODE)PATCH_Backlight=15B2A974-15B2A977
-Z(CODE)PATCH_RUN_Backlight=15B2A978-15B2A97B