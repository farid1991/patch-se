//W980_R3EG004
-carm

-Z(CODE)CODE,DATA_C=127CC380
-Z(CODE)PATCH_GUIObject_SetFocus=109D03FC
-Z(CODE)PATCH_BookObj_SetFocus=10DEFC84
-Z(CODE)PATCH_SCREENSAVER=11B22624

-Z(CODE)PATCH_Backlight=11B9036C-11B9036F
-Z(CODE)PATCH_RUN_Backlight=11B90370-11B90373