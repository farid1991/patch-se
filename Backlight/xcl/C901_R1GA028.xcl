//C901_R1GA028
-carm

-Z(CODE)ZAMAIN,CODE,DATA_C,INITTAB=15DB8C30
-Z(CODE)PATCH_GUI=144AB1A0
-Z(CODE)PATCH_SET_FOCUS=1450FD74
-Z(CODE)PATCH_SCREENSAVER=158B8E8C

-Z(CODE)PATCH_Backlight=15B0F6A8-15B0F6AB
-Z(CODE)PATCH_RUN_Backlight=15B0F6AC-15B0F6AF