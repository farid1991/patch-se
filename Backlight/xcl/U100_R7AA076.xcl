//U100_R7AA076
-carm

-Z(CODE)CODE,DATA_C=160307A0
-Z(CODE)PATCH_GUIObject_SetFocus=1469C130
-Z(CODE)PATCH_BookObj_SetFocus=14639C60
-Z(CODE)PATCH_SCREENSAVER=15912040

-Z(CODE)PATCH_Backlight=1591BDB0
-Z(CODE)PATCH_RUN_Backlight=1591BDB4
