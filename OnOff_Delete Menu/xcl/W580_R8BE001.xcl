-carm

-Z(CODE)PATCH_MarkSeveral=45AD5AF4
-Z(CODE)PATCH_Generic=45ACB4BC
-Z(CODE)PATCH_Directory=45ACA794
-Z(CODE)Patch_ONOFF=45BCCC28-45BCCC2B
-Z(CODE)Patch_Run_ONOFF=45BCCC2C-45BCCC2F
-Z(CODE)PATCH_BODY,CODE,DATA_C,DATA_Z,CONFIG_C,INITTAB=45C60D40
