-carm

-Z(CODE)PATCH_MarkSeveral=11A4268C
-Z(CODE)PATCH_Generic=11A38138
-Z(CODE)PATCH_Directory=11A37444
-Z(CODE)Patch_ONOFF=11A6EC94-11A6EC97
-Z(CODE)Patch_Run_ONOFF=11A6EC98-11A6EC9B
-Z(CODE)PATCH_BODY,CODE,DATA_C,DATA_Z,CONFIG_C,INITTAB=12193260
