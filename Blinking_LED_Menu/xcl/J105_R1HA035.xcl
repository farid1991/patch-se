//J105_R1HA035
-carm

-Z(CODE)CODE,DATA_C=15C3A450 //15C39A00
-Z(CODE)PATCH_START_TIMER=141B70A0
-Z(CODE)PATCH_KILL_TIMER=14EF1AB8
-Z(CODE)Patch_OLED=15A3C774-15A3C777
-Z(CODE)Patch_Run_OLED=15A3C778-15A3C77B
