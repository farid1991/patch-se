//U10_R1BA049
-carm

-Z(CODE)CODE,DATA_C=16203FC0

//-Z(CODE)TAB_ICON_1=144B21C0
//-Z(CODE)TAB_ICON_2=144B21F0
//-Z(CODE)TAB_ICON_3=144AC408
//-Z(CODE)TAB_FOCUS_FIX=145F06BE
//-Z(CODE)TAB_FOCUS=145F06C0 //145F03A8
//-Z(CODE)GUI_CREATE=145F0444
//-Z(CODE)BOOK_CLOSE=145F04F8
//-Z(CODE)EVENTS=151A11A8
//-Z(CODE)INTERNET=14C826FC
//-Z(CODE)SHORTCURTS=14C82718
//-Z(CODE)ACTIVETASKS=1410AA28

-Z(CODE)BM_ENTER=15BE8724
-Z(CODE)BM_CREATE=15643B00
-Z(CODE)BM_DESTROY=15643B28
