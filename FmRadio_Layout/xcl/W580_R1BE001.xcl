-carm

-Z(CODE)CODE,DATA_C,INITTAB=45DDC000

-Z(CODE)PATCH_FmRadio_OnCreate=450F8330
-Z(CODE)PATCH_FmRadio_OnClose=450F8334
-Z(CODE)PATCH_FmRadio_OnRedraw=450F8338
-Z(CODE)PATCH_FmRadio_OnKey=450F833C
-Z(CODE)PATCH_FmRadio_OnLayout=450F8340
-Z(CODE)PATCH_FmRadio_NewRefresh=450F8324

-Z(CODE)PATCH_FmRadio_NewSoftKey=450F8B1C
-Z(CODE)PATCH_FmRadio_UpdateSoftKey=450F8C7C

-Z(CODE)PATCH_FmRadio_DeleteData=450F8534

-Z(CODE)PATCH_FmRadio_MainPage_Enter=45B4AF54
-Z(CODE)PATCH_FmRadio_Created=45B4AF14