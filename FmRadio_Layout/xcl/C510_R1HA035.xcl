-carm

-Z(CODE)CODE,DATA_C,INITTAB=15DD0000

-Z(CODE)PATCH_FmRadio_OnCreate=15549D68
-Z(CODE)PATCH_FmRadio_OnClose=15549D6C
-Z(CODE)PATCH_FmRadio_OnRedraw=15549D70
-Z(CODE)PATCH_FmRadio_OnKey=15549D74
-Z(CODE)PATCH_FmRadio_NewRefresh=15549D5C

-Z(CODE)PATCH_FmRadio_NewSoftKey=1554AB18
-Z(CODE)PATCH_FmRadio_UpdateSoftKey=1554AC6C

-Z(CODE)PATCH_FmRadio_DeleteData=1554A400

-Z(CODE)PATCH_FmRadio_MainPage_Enter=15A71238
