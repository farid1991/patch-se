//W715_R1GA030
-carm
-Z(CODE)CODE,DATA_C=15DEB2F0
-Z(CODE)PATCH_FmRadio_OnCreate=1564A378
-Z(CODE)PATCH_FmRadio_OnClose=1564A37C
-Z(CODE)PATCH_FmRadio_OnRedraw=1564A380
-Z(CODE)PATCH_FmRadio_OnKey=1564A384

-Z(CODE)PATCH_FmRadio_NewSoftKeys=1564B04C
-Z(CODE)PATCH_FmRadio_UpdateSoftKeys=1564B27C
-Z(CODE)PATCH_FmRadio_DeleteData=1564AA10
-Z(CODE)PATCH_FmRadio_MainPage_Enter=15AE4A44
