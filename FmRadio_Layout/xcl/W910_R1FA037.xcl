//W910_R1FA037
-carm
-Z(CODE)CODE,DATA_C=1223D000
-Z(CODE)PATCH_FmRadio_OnCreate=11303928
-Z(CODE)PATCH_FmRadio_OnClose=1130392C
-Z(CODE)PATCH_FmRadio_OnRedraw=11303930
-Z(CODE)PATCH_FmRadio_OnKey=11303934
-Z(CODE)PATCH_FmRadio_NewSoftKeys=11304404
-Z(CODE)PATCH_FmRadio_UpdateSoftKeys=11304494
-Z(CODE)PATCH_FmRadio_DeleteData=11303C50
-Z(CODE)PATCH_FmRadio_MainPage_Enter=11ADD458
-Z(CODE)PATCH_FmRadio_Created=11ADD400
