//W995_R1GA026
-carm
-Z(CODE)CODE,DATA_C,INITTAB=15F05230
-Z(CODE)PATCH_FmRadio_OnCreate=15064730
-Z(CODE)PATCH_FmRadio_OnClose=15064734
-Z(CODE)PATCH_FmRadio_OnRedraw=15064738
-Z(CODE)PATCH_FmRadio_OnKey=1506473C
-Z(CODE)PATCH_FmRadio_NewRefresh=15064724
-Z(CODE)PATCH_FmRadio_NewSoftKey=14FC9C94
-Z(CODE)PATCH_FmRadio_UpdateSoftKey=14F928CC
-Z(CODE)PATCH_FmRadio_DeleteData=14F52084
-Z(CODE)PATCH_FmRadio_MainPage_Enter=15B87878
