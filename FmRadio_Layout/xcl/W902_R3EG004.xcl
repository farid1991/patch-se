//W902_R3EG004

-carm
-Z(CODE)CODE,DATA_C=12828900
-Z(CODE)PATCH_FmRadio_OnCreate=10FAC460
-Z(CODE)PATCH_FmRadio_OnClose=10FAC464
-Z(CODE)PATCH_FmRadio_OnRedraw=10FAC468
-Z(CODE)PATCH_FmRadio_OnKey=10FAC46C

-Z(CODE)PATCH_FmRadio_NewSoftKeys=10FAD2E8
-Z(CODE)PATCH_FmRadio_UpdateSoftKeys=10FAD378
-Z(CODE)PATCH_FmRadio_DeleteData=10FACB48
-Z(CODE)PATCH_FmRadio_MainPage_Enter=11C22108
-Z(CODE)PATCH_FmRadio_Created=11C22088
