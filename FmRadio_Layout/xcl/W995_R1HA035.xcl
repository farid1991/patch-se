//W995_R1HA035
-carm
-Z(CODE)CODE,DATA_C=15F00AA0
-Z(CODE)PATCH_FmRadio_OnCreate=15068090
-Z(CODE)PATCH_FmRadio_OnClose=15068094
-Z(CODE)PATCH_FmRadio_OnRedraw=15068098
-Z(CODE)PATCH_FmRadio_OnKey=1506809C
-Z(CODE)PATCH_FmRadio_NewSoftKeys=14FCCB5C
-Z(CODE)PATCH_FmRadio_UpdateSoftKeys=14F955D4
-Z(CODE)PATCH_FmRadio_DeleteData=14F54C14
-Z(CODE)PATCH_FmRadio_MainPage_Enter=15B91020
-Z(CODE)PATCH_FmRadio_Created=15B90F78
