//W980_R3EG004
-carm
-Z(CODE)CODE,DATA_C=127C1E60
-Z(CODE)PATCH_FmRadio_OnCreate=10FAB808
-Z(CODE)PATCH_FmRadio_OnClose=10FAB80C
-Z(CODE)PATCH_FmRadio_OnRedraw=10FAB810
-Z(CODE)PATCH_FmRadio_OnKey=10FAB814
-Z(CODE)PATCH_FmRadio_NewSoftKeys=10FAD68C
-Z(CODE)PATCH_FmRadio_UpdateSoftKeys=10FAD71C
-Z(CODE)PATCH_FmRadio_DeleteData=10FACE74
-Z(CODE)PATCH_FmRadio_MainPage_Enter=11C0AE1C
-Z(CODE)PATCH_FmRadio_Created=11C0AD9C
