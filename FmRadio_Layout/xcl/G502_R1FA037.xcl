//G502_R1FA037
-carm
-Z(CODE)CODE,DATA_C,INITTAB=121B2700
-Z(CODE)PATCH_FmRadio_OnCreate=1132A2B8
-Z(CODE)PATCH_FmRadio_OnClose=1132A2BC
-Z(CODE)PATCH_FmRadio_OnRedraw=1132A2C0
-Z(CODE)PATCH_FmRadio_OnKey=1132A2C4
-Z(CODE)PATCH_FmRadio_OnLayout=1132A2C8
-Z(CODE)PATCH_FmRadio_NewSoftKeys=1132ACDC
-Z(CODE)PATCH_FmRadio_UpdateSoftKeys=1132AE24
-Z(CODE)PATCH_Fix_FMRadio_Gui=1132C8DC
-Z(CODE)PATCH_FmRadio_LoadData=1132D288
-Z(CODE)PATCH_FmRadio_DeleteData=1132A5E0
-Z(CODE)PATCH_FmRadio_MainPage_Enter=11B07E34
-Z(CODE)PATCH_FmRadio_Created=11B07DB4