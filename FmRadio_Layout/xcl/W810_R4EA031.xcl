//W810_R4EA031
-carm
-Z(CODE)CODE,DATA_C,INITTAB=457003E0
-Z(CODE)PATCH_FmRadio_OnCreate=45276E9C
-Z(CODE)PATCH_FmRadio_OnClose=45276EA0
-Z(CODE)PATCH_FmRadio_OnRedraw=45276EA4
-Z(CODE)PATCH_FmRadio_OnKey=45276EA8
-Z(CODE)PATCH_FmRadio_OnConfig=45276EB0
-Z(CODE)PATCH_FmRadio_RemoveTitle=455FE168
-Z(CODE)PATCH_FmRadio_NewSoftKeys=455FE3E0
-Z(CODE)PATCH_FmRadio_UpdateSoftKeys=455FE484
-Z(CODE)PATCH_FmRadio_DeleteData=455FDE0C
-Z(CODE)PATCH_FmRadio_MainPage_Enter=44534018
-Z(CODE)PATCH_FmRadio_Created=44533FF8
