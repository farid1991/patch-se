//W508_R1FA035
-carm
-Z(CODE)CODE,DATA_C=15CD5D40
-Z(CODE)PATCH_FmRadio_OnCreate=1553639C
-Z(CODE)PATCH_FmRadio_OnClose=155363A0
-Z(CODE)PATCH_FmRadio_OnRedraw=155363A4
-Z(CODE)PATCH_FmRadio_OnKey=155363A8
-Z(CODE)PATCH_FmRadio_NewSoftKeys=1553702C
-Z(CODE)PATCH_FmRadio_UpdateSoftKeys=1553725C
-Z(CODE)PATCH_FmRadio_DeleteData=155369E0
-Z(CODE)PATCH_FmRadio_MainPage_Enter=159A7714
