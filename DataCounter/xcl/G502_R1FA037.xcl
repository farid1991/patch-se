-carm

-Z(CODE)PATCH_LASTSESSION_SENT=10F411FC
-Z(CODE)PATCH_LASTSESSION_RECV=10F4122C
-Z(CODE)PATCH_ALLSESSION_SENT=10F412C8
-Z(CODE)PATCH_ALLSESSION_RECV=10F412FC

-Z(CODE)PATCH_BODY,CODE,DATA_C,INITTAB=12100410
