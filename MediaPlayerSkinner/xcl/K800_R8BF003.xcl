//K800_R8BF003
-carm
-Z(CODE)CODE,DATA_C=45D9EB00
-Z(CODE)PATCH_MediaPlayer_Audio_OnCreate=4503E8D4
-Z(CODE)PATCH_MediaPlayer_Audio_OnClose=4503E8D8
-Z(CODE)PATCH_MediaPlayer_Audio_OnRedraw=4503E8DC
-Z(CODE)PATCH_MediaPlayer_Audio_SetStyle=4503E100
-Z(CODE)PATCH_MediaPlayer_NowPlaying_OnCreate=4503F670
-Z(CODE)PATCH_MediaPlayer_NowPlaying_OnClose=4503F674
-Z(CODE)PATCH_MediaPlayer_NowPlaying_OnRedraw=4503F678
-Z(CODE)PATCH_MediaPlayer_NowPlaying_SetSize=4503E338
-Z(CODE)PATCH_MediaPlayer_SoftKeys=450417C8

-Z(CODE)PATCH_GUI_MEDIAPLAYER=45044F14
-Z(CODE)PATCH_GUI_PLAYMODE=45046360
-Z(CODE)PATCH_GUI_STEREOWIDENING=45046550

-Z(CODE)PATCH_MEDIAPLAYER_CREATED_EVENT=45B83884
-Z(CODE)PATCH_MEDIAPLAYER_AUDIO_PLAYING_TIME_EVENT=45B837EC
