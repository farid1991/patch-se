//C510_R1HA035
-carm
-Z(CODE)CODE,DATA_C=15D13800

-Z(CODE)PATCH_STATUSROW_ONREDRAW=141630D4
-Z(CODE)PATCH_SOFTKEYS_ONREDRAW=141A4C18
-Z(CODE)PATCH_STATUSINDICATION_ONCREATE=14048ACC
-Z(CODE)PATCH_STATUSINDICATION_ONCLOSE=14048AD0
-Z(CODE)PATCH_STATUSINDICATION_ONREDRAW=14048AD4
-Z(CODE)PATCH_STATUSINDICATION_ONMETHOD06=14048AD8
-Z(CODE)PATCH_STATUSINDICATION_ONMETHOD0A=14048ADC
-Z(CODE)PATCH_MAININPUT_ONKEY=14040EC4

-Z(CODE)PATCH_CALLOFF_CLEAR=14E73020
-Z(CODE)PATCH_SET_TRAY_ICON=1417A768
