-carm

-Z(CODE)PATCH_BODY,CODE,DATA_C,DATA_Z,CONFIG_C,INITTAB=121980D0
-Z(CODE)PATCH_MELODY_SELECT1=1127A0CC
-Z(CODE)PATCH_MELODY_SELECT2=1127A0F8
-Z(CODE)PATCH_NEW_SK1=1127955C
-Z(CODE)PATCH_NEW_SK2=112795D0
