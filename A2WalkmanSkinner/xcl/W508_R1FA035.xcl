//W508_R1FA035
-carm
-Z(CODE)CODE,DATA_C=15CDE150

-Z(CODE)PATCH_ONCREATE_HOOK=14111720
-Z(CODE)PATCH_ONCLOSE_HOOK=14111724
-Z(CODE)PATCH_ONREDRAW_HOOK=14111728
-Z(CODE)PATCH_MUSIC_KEYBOARD1=14D2C31C 
-Z(CODE)PATCH_MUSIC_KEYBOARD2=14F08C00 

-Z(CODE)PATCH_UPDATE_ORIENTATION_HOOK_1=14366870
-Z(CODE)PATCH_UPDATE_ORIENTATION_HOOK_2=1436684C
-Z(CODE)PATCH_UPDATE_ORIENTATION_HOOK_3=14366860

-Z(CODE)PATCH_Walkman_GUI=14461564
-Z(CODE)PATCH_Walkman_SoftKeys=145B4A08
-Z(CODE)PATCH_StereoWidening=1532E870
-Z(CODE)PATCH_UPDATE_LOOP_HOOK=1532D2B0
-Z(CODE)PATCH_UPDATE_SHUFFLE_HOOK=1532D27C

-Z(CODE)PATCH_UI_MEDIAPLAYER_ON_NEW_TRACK_HOOK=1593F7B8
-Z(CODE)PATCH_UI_MEDIAPLAYER_AUDIO_PLAYING_TIME_EVENT_HOOK=1593F7A0
-Z(CODE)PATCH_UI_MEDIAPLAYER_CREATED_EVENT_HOOK=1593F778
-Z(CODE)PATCH_UI_MEDIAPLAYER_ON_ENTER_PAGE_HOOK=1593F8B0

-Z(CODE)PATCH_Feedback_DrawCoverArt=14D4700C
-Z(CODE)PATCH_Feedback_RemoveIcon=14FAA118

-Z(CODE)PATCH_Equalizer_EnterEvent=1593F958
-Z(CODE)PATCH_Equalizer_CancelEvent=1593F968

-Z(CODE)PATCH_SetEqualizerGain=14F5C584
