//K660_R1FA037
-carm
-Z(CODE)CODE,DATA_C=121A0000

-Z(CODE)PATCH_ONCREATE_HOOK=115BF5D4
-Z(CODE)PATCH_ONCLOSE_HOOK=115BF5D8
-Z(CODE)PATCH_ONREDRAW_HOOK=115BF5DC
-Z(CODE)PATCH_MUSIC_KEYBOARD1=115BA438 
-Z(CODE)PATCH_MUSIC_KEYBOARD2=115BA958

-Z(CODE)PATCH_UPDATE_ORIENTATION_HOOK=11606328

-Z(CODE)PATCH_Walkman_GUI=115C00D0
-Z(CODE)PATCH_Walkman_SoftKeys=115BB6F0
-Z(CODE)PATCH_Visualization=115BB9B8
-Z(CODE)PATCH_StereoWidening=115BD0C0

-Z(CODE)PATCH_UPDATE_LOOP_HOOK=115BAC9C
-Z(CODE)PATCH_UPDATE_SHUFFLE_HOOK=115BAC70

-Z(CODE)PATCH_UI_MEDIAPLAYER_ON_NEW_TRACK_HOOK=11B677C0
-Z(CODE)PATCH_UI_MEDIAPLAYER_AUDIO_PLAYING_TIME_EVENT_HOOK=11B677A8
-Z(CODE)PATCH_UI_MEDIAPLAYER_CREATED_EVENT_HOOK=11B67788
-Z(CODE)PATCH_UI_MEDIAPLAYER_ON_ENTER_PAGE_HOOK=11B67818

-Z(CODE)PATCH_Feedback_DrawCoverArt=1160CC64
-Z(CODE)PATCH_Feedback_RemoveIcon=1160CB34

-Z(CODE)PATCH_Equalizer_EnterEvent=11B67860
-Z(CODE)PATCH_Equalizer_CancelEvent=11B67870

-Z(CODE)PATCH_SetEqualizerGain=115BA224
