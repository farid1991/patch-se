//W760_R3EM001
-carm
-Z(CODE)CODE,DATA_C=12820000

-Z(CODE)PATCH_ONCREATE_HOOK=10B8FD10
-Z(CODE)PATCH_ONCLOSE_HOOK=10B8FD14
-Z(CODE)PATCH_ONREDRAW_HOOK=10B8FD18
-Z(CODE)PATCH_MUSIC_KEYBOARD1=10D21F80
-Z(CODE)PATCH_MUSIC_KEYBOARD2=10D2273C

-Z(CODE)PATCH_UPDATE_ORIENTATION_HOOK=10E8A380

-Z(CODE)PATCH_Walkman_GUI=10B90868
-Z(CODE)PATCH_Walkman_SoftKeys=10D2345C
-Z(CODE)PATCH_StereoWidening=10D25DAC
-Z(CODE)PATCH_UPDATE_LOOP_HOOK=10D22A8C
-Z(CODE)PATCH_UPDATE_SHUFFLE_HOOK=10D22A58

-Z(CODE)PATCH_UI_MEDIAPLAYER_ON_NEW_TRACK_HOOK=11C2F89C
-Z(CODE)PATCH_UI_MEDIAPLAYER_AUDIO_PLAYING_TIME_EVENT_HOOK=11C2F884
-Z(CODE)PATCH_UI_MEDIAPLAYER_CREATED_EVENT_HOOK=11C2F864
-Z(CODE)PATCH_UI_MEDIAPLAYER_ON_ENTER_PAGE_HOOK=11C2F97C

-Z(CODE)PATCH_Feedback_DrawCoverArt=11AE9D98
-Z(CODE)PATCH_Feedback_RemoveIcon=11AE9B14

-Z(CODE)PATCH_Equalizer_EnterEvent=11C2FA24
-Z(CODE)PATCH_Equalizer_CancelEvent=11C2FA34

-Z(CODE)PATCH_SetEqualizerGain=10D21C78
