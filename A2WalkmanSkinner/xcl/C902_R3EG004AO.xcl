//C902_R3EG004AO
-carm
-Z(CODE)CODE,DATA_C=127C80C0

-Z(CODE)PATCH_ONCREATE_HOOK=10AD38AC
-Z(CODE)PATCH_ONCLOSE_HOOK=10AD38B0
-Z(CODE)PATCH_ONREDRAW_HOOK=10AD38B4
-Z(CODE)PATCH_MUSIC_KEYBOARD1=10C68C78
-Z(CODE)PATCH_MUSIC_KEYBOARD2=10C6926C

-Z(CODE)PATCH_UPDATE_ORIENTATION_HOOK=10DD4BFC

-Z(CODE)PATCH_Walkman_GUI=10AD4414
-Z(CODE)PATCH_Walkman_SoftKeys=10C69FA4
-Z(CODE)PATCH_StereoWidening=10C6BEFC
-Z(CODE)PATCH_UPDATE_SHUFFLE_HOOK=10C6958C

-Z(CODE)PATCH_UI_MEDIAPLAYER_ON_NEW_TRACK_HOOK=11B9EBFC
-Z(CODE)PATCH_UI_MEDIAPLAYER_AUDIO_PLAYING_TIME_EVENT_HOOK=11B9EBE4
-Z(CODE)PATCH_UI_MEDIAPLAYER_CREATED_EVENT_HOOK=11B9EBC4
-Z(CODE)PATCH_UI_MEDIAPLAYER_ON_ENTER_PAGE_HOOK=11B9EC94

-Z(CODE)PATCH_Feedback_DrawCoverArt=11A5812C
-Z(CODE)PATCH_Feedback_RemoveIcon=11A57EA8

-Z(CODE)PATCH_Equalizer_EnterEvent=11B9ED34
-Z(CODE)PATCH_Equalizer_CancelEvent=11B9ED44

-Z(CODE)PATCH_SetEqualizerGain=10C6896C
