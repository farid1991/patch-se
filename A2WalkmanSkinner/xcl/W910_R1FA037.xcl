//W910_R1FA037
-carm
-Z(CODE)CODE,DATA_C=121A2770

-Z(CODE)PATCH_ONCREATE_HOOK=11589E80
-Z(CODE)PATCH_ONCLOSE_HOOK=11589E84
-Z(CODE)PATCH_ONREDRAW_HOOK=11589E88
-Z(CODE)PATCH_MUSIC_KEYBOARD1=115844E4
-Z(CODE)PATCH_MUSIC_KEYBOARD2=11584B50

-Z(CODE)PATCH_UPDATE_ORIENTATION_HOOK=115D3290

-Z(CODE)PATCH_Walkman_GUI=1158A97C
-Z(CODE)PATCH_Walkman_SoftKeys=115858A0
-Z(CODE)PATCH_Visualization=11585BF8
-Z(CODE)PATCH_StereoWidening=1158781C

-Z(CODE)PATCH_UPDATE_LOOP_HOOK=11584E90
-Z(CODE)PATCH_UPDATE_SHUFFLE_HOOK=11584E64

-Z(CODE)PATCH_UI_MEDIAPLAYER_ON_NEW_TRACK_HOOK=11B3BCC4
-Z(CODE)PATCH_UI_MEDIAPLAYER_AUDIO_PLAYING_TIME_EVENT_HOOK=11B3BCAC
-Z(CODE)PATCH_UI_MEDIAPLAYER_CREATED_EVENT_HOOK=11B3BC8C
-Z(CODE)PATCH_UI_MEDIAPLAYER_ON_ENTER_PAGE_HOOK=11B3BD54

-Z(CODE)PATCH_Feedback_DrawCoverArt=115D9BC4
-Z(CODE)PATCH_Feedback_RemoveIcon=115D9A94

-Z(CODE)PATCH_Equalizer_EnterEvent=11B3BDE4
-Z(CODE)PATCH_Equalizer_CancelEvent=11B3BDF4

-Z(CODE)PATCH_SetEqualizerGain=115842CC
