//T715_R1GA026
-carm
-Z(CODE)CODE,DATA_C=15CF0000

-Z(CODE)PATCH_ONCREATE_HOOK=14D1F588
-Z(CODE)PATCH_ONCLOSE_HOOK=14D1F58C
-Z(CODE)PATCH_ONREDRAW_HOOK=14D1F590

-Z(CODE)PATCH_MUSIC_KEYBOARD1=15015FF0
-Z(CODE)PATCH_MUSIC_KEYBOARD2=150162B8

-Z(CODE)PATCH_UPDATE_ORIENTATION_HOOK_1=1439CAB8
-Z(CODE)PATCH_UPDATE_ORIENTATION_HOOK_2=1439CA94
-Z(CODE)PATCH_UPDATE_ORIENTATION_HOOK_3=1439CAA8

-Z(CODE)PATCH_Walkman_GUI=15015CCC
-Z(CODE)PATCH_Walkman_SoftKeys=14D091C8
-Z(CODE)PATCH_StereoWidening=14CF4CDC
-Z(CODE)PATCH_UPDATE_LOOP_HOOK=14E3F66C
-Z(CODE)PATCH_UPDATE_SHUFFLE_HOOK=14E3F638

-Z(CODE)PATCH_UI_MEDIAPLAYER_ON_NEW_TRACK_HOOK=1592CD00
-Z(CODE)PATCH_UI_MEDIAPLAYER_AUDIO_PLAYING_TIME_EVENT_HOOK=1592CCE8
-Z(CODE)PATCH_UI_MEDIAPLAYER_CREATED_EVENT_HOOK=1592CCC0
-Z(CODE)PATCH_UI_MEDIAPLAYER_ON_ENTER_PAGE_HOOK=1592CD98
-Z(CODE)PATCH_UI_MEDIAPLAYER_ON_EXIT_PAGE_HOOK=1592CDC8

-Z(CODE)PATCH_Feedback_DrawCoverArt=14CCACE4
-Z(CODE)PATCH_Feedback_RemoveIcon=14E53EC4
