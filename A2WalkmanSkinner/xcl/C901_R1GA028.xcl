//C901_R1GA028
-carm
-Z(CODE)CODE,DATA_C=15E06340

-Z(CODE)PATCH_ONCREATE_HOOK=14D27A1C
-Z(CODE)PATCH_ONCLOSE_HOOK=14D27A20
-Z(CODE)PATCH_ONREDRAW_HOOK=14D27A24

-Z(CODE)PATCH_MUSIC_KEYBOARD1=15022BCC
-Z(CODE)PATCH_MUSIC_KEYBOARD2=15022E94

-Z(CODE)PATCH_UPDATE_ORIENTATION_HOOK=1439FEB0
-Z(CODE)PATCH_UPDATE_ORIENTATION_HOOK_2=1439FE8C
-Z(CODE)PATCH_UPDATE_ORIENTATION_HOOK_3=1439FEA0

-Z(CODE)PATCH_Walkman_GUI=150228A8
-Z(CODE)PATCH_Walkman_SoftKeys=14D1127C
-Z(CODE)PATCH_StereoWidening=14CFCD78
-Z(CODE)PATCH_UPDATE_LOOP_HOOK=14E49624
-Z(CODE)PATCH_UPDATE_SHUFFLE_HOOK=14E495F0

-Z(CODE)PATCH_UI_MEDIAPLAYER_ON_NEW_TRACK_HOOK=15940EDC
-Z(CODE)PATCH_UI_MEDIAPLAYER_AUDIO_PLAYING_TIME_EVENT_HOOK=15940EC4
-Z(CODE)PATCH_UI_MEDIAPLAYER_CREATED_EVENT_HOOK=15940E9C
-Z(CODE)PATCH_UI_MEDIAPLAYER_ON_ENTER_PAGE_HOOK=15940F74

-Z(CODE)PATCH_Feedback_DrawCoverArt=14CD2CB4
-Z(CODE)PATCH_Feedback_RemoveIcon=14E5E55C

-Z(CODE)PATCH_Equalizer_EnterEvent=15941014
-Z(CODE)PATCH_Equalizer_CancelEvent=15941024

-Z(CODE)PATCH_SetEqualizerGain=14D87244
