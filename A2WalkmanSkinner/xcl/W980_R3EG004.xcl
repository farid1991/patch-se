//W980_R3EG004
-carm
-Z(CODE)CODE,DATA_C=12810000 

-Z(CODE)PATCH_ONCREATE_HOOK=10AF134C
-Z(CODE)PATCH_ONCLOSE_HOOK=10AF1350
-Z(CODE)PATCH_ONREDRAW_HOOK=10AF1354
-Z(CODE)PATCH_MUSIC_KEYBOARD1=10C855B0
-Z(CODE)PATCH_MUSIC_KEYBOARD2=10C85EB0

-Z(CODE)PATCH_UPDATE_ORIENTATION_HOOK=10DF01A8

-Z(CODE)PATCH_Walkman_GUI=10AF1F34
-Z(CODE)PATCH_Walkman_SoftKeys=10C869D8
-Z(CODE)PATCH_UPDATE_LOOP_HOOK=10C86200
-Z(CODE)PATCH_UPDATE_SHUFFLE_HOOK=10C861CC

-Z(CODE)PATCH_UI_MEDIAPLAYER_ON_NEW_TRACK_HOOK=11BAC658
-Z(CODE)PATCH_UI_MEDIAPLAYER_AUDIO_PLAYING_TIME_EVENT_HOOK=11BAC640
-Z(CODE)PATCH_UI_MEDIAPLAYER_CREATED_EVENT_HOOK=11BAC620
-Z(CODE)PATCH_UI_MEDIAPLAYER_ON_ENTER_PAGE_HOOK=11BAC740

-Z(CODE)PATCH_Feedback_DrawCoverArt=11A66114
-Z(CODE)PATCH_Feedback_RemoveIcon=11A65E90
