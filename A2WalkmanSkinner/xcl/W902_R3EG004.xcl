//W902_R3EG004
-carm
-Z(CODE)CODE,DATA_C=12810000 

-Z(CODE)PATCH_ONCREATE_HOOK=10AFAA00
-Z(CODE)PATCH_ONCLOSE_HOOK=10AFAA04
-Z(CODE)PATCH_ONREDRAW_HOOK=10AFAA08
-Z(CODE)PATCH_MUSIC_KEYBOARD1=10C8F76C
-Z(CODE)PATCH_MUSIC_KEYBOARD2=10C8FF0C

-Z(CODE)PATCH_Walkman_GUI=10AFB568
-Z(CODE)PATCH_Walkman_SoftKeys=10C909A8
-Z(CODE)PATCH_UPDATE_ORIENTATION_HOOK=10DF8E74
-Z(CODE)PATCH_UPDATE_LOOP_HOOK=10C9025C
-Z(CODE)PATCH_UPDATE_SHUFFLE_HOOK=10C90228

-Z(CODE)PATCH_UI_MEDIAPLAYER_ON_NEW_TRACK_HOOK=11BC6480
-Z(CODE)PATCH_UI_MEDIAPLAYER_AUDIO_PLAYING_TIME_EVENT_HOOK=11BC6468
-Z(CODE)PATCH_UI_MEDIAPLAYER_CREATED_EVENT_HOOK=11BC6448
-Z(CODE)PATCH_UI_MEDIAPLAYER_ON_ENTER_PAGE_HOOK=11BC6558

-Z(CODE)PATCH_Feedback_DrawCoverArt=11A7CC14
-Z(CODE)PATCH_Feedback_RemoveIcon=11A7C990
