-carm
-Z(CODE)CODE,DATA_C=15DD7300

-Z(CODE)PATCH_ONCREATE_HOOK=14D971A4
-Z(CODE)PATCH_ONCLOSE_HOOK=14D971A8
-Z(CODE)PATCH_ONREDRAW_HOOK=14D971AC
-Z(CODE)PATCH_MUSIC_KEYBOARD1=14E0652C
-Z(CODE)PATCH_MUSIC_KEYBOARD2=14FDE84C

-Z(CODE)PATCH_UPDATE_ORIENTATION_HOOK_2=1412AD74
-Z(CODE)PATCH_UPDATE_ORIENTATION_HOOK_3=1412AD88
-Z(CODE)PATCH_UPDATE_ORIENTATION_HOOK_1=1412AD98

-Z(CODE)PATCH_UPDATE_SHUFFLE_HOOK=14EE4444
-Z(CODE)PATCH_UPDATE_LOOP_HOOK=14EE4478
-Z(CODE)PATCH_StereoWidening=1544F2C4

-Z(CODE)PATCH_Walkman_GUI=14E06660
-Z(CODE)PATCH_Walkman_SoftKeys=14FDE280

-Z(CODE)PATCH_UI_MEDIAPLAYER_ON_NEW_TRACK_HOOK=15A7CF14
-Z(CODE)PATCH_UI_MEDIAPLAYER_AUDIO_PLAYING_TIME_EVENT_HOOK=15A7CEFC
-Z(CODE)PATCH_UI_MEDIAPLAYER_CREATED_EVENT_HOOK=15A7CED4
-Z(CODE)PATCH_UI_MEDIAPLAYER_ON_ENTER_PAGE_HOOK=15A7CFEC

-Z(CODE)PATCH_Feedback_DrawCoverArt=14D201B4
-Z(CODE)PATCH_Feedback_RemoveIcon=14F8AAE0
