//W995_R1HA035
-carm
-Z(CODE)CODE,DATA_C=15E7F4F0

-Z(CODE)PATCH_ONCREATE_HOOK=14DE35DC
-Z(CODE)PATCH_ONCLOSE_HOOK=14DE35E0
-Z(CODE)PATCH_ONREDRAW_HOOK=14DE35E4
-Z(CODE)PATCH_MUSIC_KEYBOARD1=150DF97C
-Z(CODE)PATCH_MUSIC_KEYBOARD2=150DFCB4

-Z(CODE)PATCH_UPDATE_ORIENTATION_HOOK_1=143A152C
-Z(CODE)PATCH_UPDATE_ORIENTATION_HOOK_2=143A1508
-Z(CODE)PATCH_UPDATE_ORIENTATION_HOOK_3=143A151C
-Z(CODE)PATCH_UPDATE_ORIENTATION_HOOK_4=1416FE20

-Z(CODE)PATCH_Walkman_GUI=150DF658
-Z(CODE)PATCH_Walkman_SoftKeys=14DCCE5C
-Z(CODE)PATCH_StereoWidening=14DB8840
-Z(CODE)PATCH_UPDATE_LOOP_HOOK=14F05084
-Z(CODE)PATCH_UPDATE_SHUFFLE_HOOK=14F05050

-Z(CODE)PATCH_UI_MEDIAPLAYER_ON_NEW_TRACK_HOOK=15A7A864
-Z(CODE)PATCH_UI_MEDIAPLAYER_AUDIO_PLAYING_TIME_EVENT_HOOK=15A7A84C
-Z(CODE)PATCH_UI_MEDIAPLAYER_CREATED_EVENT_HOOK=15A7A824
-Z(CODE)PATCH_UI_MEDIAPLAYER_ON_ENTER_PAGE_HOOK=15A7A93C

-Z(CODE)PATCH_Feedback_DrawCoverArt=14D8E5F0
-Z(CODE)PATCH_Feedback_RemoveIcon=14F1A000
