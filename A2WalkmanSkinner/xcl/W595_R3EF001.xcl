//W595_R3EF001
-carm
-Z(CODE)CODE,DATA_C=127E5000 //127D0000

-Z(CODE)PATCH_ONCREATE_HOOK=10AF21AC
-Z(CODE)PATCH_ONCLOSE_HOOK=10AF21B0
-Z(CODE)PATCH_ONREDRAW_HOOK=10AF21B4
-Z(CODE)PATCH_MUSIC_KEYBOARD1=10C86A94
-Z(CODE)PATCH_MUSIC_KEYBOARD2=10C87250

-Z(CODE)PATCH_UPDATE_ORIENTATION_HOOK=10DF0F00

-Z(CODE)PATCH_Walkman_GUI=10AF2D14
-Z(CODE)PATCH_Walkman_SoftKeys=10C87FFC
-Z(CODE)PATCH_StereoWidening=10C8A8C0
-Z(CODE)PATCH_UPDATE_LOOP_HOOK=10C875A0
-Z(CODE)PATCH_UPDATE_SHUFFLE_HOOK=10C8756C

-Z(CODE)PATCH_UI_MEDIAPLAYER_ON_NEW_TRACK_HOOK=11BA0600
-Z(CODE)PATCH_UI_MEDIAPLAYER_AUDIO_PLAYING_TIME_EVENT_HOOK=11BA05E8
-Z(CODE)PATCH_UI_MEDIAPLAYER_CREATED_EVENT_HOOK=11BA05C8
-Z(CODE)PATCH_UI_MEDIAPLAYER_ON_ENTER_PAGE_HOOK=11BA06E0

-Z(CODE)PATCH_Feedback_DrawCoverArt=11A571A0
-Z(CODE)PATCH_Feedback_RemoveIcon=11A56F1C

-Z(CODE)PATCH_Equalizer_EnterEvent=11BA0788
-Z(CODE)PATCH_Equalizer_CancelEvent=11BA0798

-Z(CODE)PATCH_SetEqualizerGain=10C8678C
