-carm
-Z(CODE)CODE,DATA_C=15D96790
-Z(CODE)PATCH_ONREDRAW_HOOK=14D01FF4
-Z(CODE)PATCH_ONCREATE_HOOK=14D01FEC
-Z(CODE)PATCH_ONCLOSE_HOOK=14D01FF0
-Z(CODE)PATCH_MUSIC_KEYBOARD1=14D71374
-Z(CODE)PATCH_MUSIC_KEYBOARD2=14F49694

-Z(CODE)PATCH_UPDATE_ORIENTATION_HOOK_1=1412AD98
-Z(CODE)PATCH_UPDATE_ORIENTATION_HOOK_2=1412AD74
-Z(CODE)PATCH_UPDATE_ORIENTATION_HOOK_3=1412AD88

-Z(CODE)PATCH_UPDATE_SHUFFLE_HOOK=14E4F28C
-Z(CODE)PATCH_UPDATE_LOOP_HOOK=14E4F2C0
-Z(CODE)PATCH_StereoWidening=153BA114

-Z(CODE)PATCH_Walkman_GUI=14D714A8
-Z(CODE)PATCH_Walkman_SoftKeys=14F490C8

-Z(CODE)PATCH_UI_MEDIAPLAYER_ON_NEW_TRACK_HOOK=159E4EFC
-Z(CODE)PATCH_UI_MEDIAPLAYER_AUDIO_PLAYING_TIME_EVENT_HOOK=159E4EE4
-Z(CODE)PATCH_UI_MEDIAPLAYER_CREATED_EVENT_HOOK=159E4EBC
-Z(CODE)PATCH_UI_MEDIAPLAYER_ON_ENTER_PAGE_HOOK=159E4FD4

-Z(CODE)PATCH_Feedback_DrawCoverArt=14C8B060
-Z(CODE)PATCH_Feedback_RemoveIcon=14EF5928
