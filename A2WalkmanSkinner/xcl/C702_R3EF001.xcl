//C702_R3EF001
-carm
-Z(CODE)CODE,DATA_C=127D0000

-Z(CODE)PATCH_ONCREATE_HOOK=10B61398
-Z(CODE)PATCH_ONCLOSE_HOOK=10B6139C
-Z(CODE)PATCH_ONREDRAW_HOOK=10B613A0
-Z(CODE)PATCH_MUSIC_KEYBOARD1=10CF60BC
-Z(CODE)PATCH_MUSIC_KEYBOARD2=10CF66B0

-Z(CODE)PATCH_UPDATE_ORIENTATION_HOOK=10E61C98

-Z(CODE)PATCH_Walkman_GUI=10B61F00
-Z(CODE)PATCH_Walkman_SoftKeys=10CF7390
-Z(CODE)PATCH_StereoWidening=10CF9340
-Z(CODE)PATCH_UPDATE_SHUFFLE_HOOK=10CF69D0

-Z(CODE)PATCH_UI_MEDIAPLAYER_ON_NEW_TRACK_HOOK=11C170E0
-Z(CODE)PATCH_UI_MEDIAPLAYER_AUDIO_PLAYING_TIME_EVENT_HOOK=11C170C8
-Z(CODE)PATCH_UI_MEDIAPLAYER_CREATED_EVENT_HOOK=11C170A8
-Z(CODE)PATCH_UI_MEDIAPLAYER_ON_ENTER_PAGE_HOOK=11C17178

-Z(CODE)PATCH_Feedback_DrawCoverArt=11AD009C
-Z(CODE)PATCH_Feedback_RemoveIcon=11ACFE18

-Z(CODE)PATCH_Equalizer_EnterEvent=11C17218
-Z(CODE)PATCH_Equalizer_CancelEvent=11C17228

-Z(CODE)PATCH_SetEqualizerGain=10CF5DB0
