-carm
-Z(CODE)CODE,DATA_C=15D2F710

-Z(CODE)PATCH_ONCREATE_HOOK=14CD5FEC
-Z(CODE)PATCH_ONCLOSE_HOOK=14CD5FF0
-Z(CODE)PATCH_ONREDRAW_HOOK=14CD5FF4
-Z(CODE)PATCH_ONKEY_HOOK=14430150
-Z(CODE)PATCH_MUSIC_KEYBOARD1=14D44480
-Z(CODE)PATCH_MUSIC_KEYBOARD2=14F152C0

-Z(CODE)PATCH_UPDATE_ORIENTATION_HOOK=14129788
-Z(CODE)PATCH_UPDATE_ORIENTATION_HOOK_2=14129764
-Z(CODE)PATCH_UPDATE_ORIENTATION_HOOK_3=14129778

-Z(CODE)PATCH_START_TIMER=1024BFD4
-Z(CODE)PATCH_START_TIMER_2=100BC4CC
-Z(CODE)PATCH_STOP_TIMER=10269DBC
-Z(CODE)PATCH_STOP_TIMER_2=100BC0F0

-Z(CODE)PATCH_Walkman_GUI=14D445B4
-Z(CODE)PATCH_Walkman_SoftKeys=14F14D6C
-Z(CODE)PATCH_StereoWidening=1534888C
-Z(CODE)PATCH_UPDATE_LOOP_HOOK=14E1FA2C
-Z(CODE)PATCH_UPDATE_SHUFFLE_HOOK=14E1F9F8

-Z(CODE)PATCH_UI_MEDIAPLAYER_ON_NEW_TRACK_HOOK=1595BC48
-Z(CODE)PATCH_UI_MEDIAPLAYER_AUDIO_PLAYING_TIME_EVENT_HOOK=1595BC30
-Z(CODE)PATCH_UI_MEDIAPLAYER_CREATED_EVENT_HOOK=1595BC08
-Z(CODE)PATCH_UI_MEDIAPLAYER_ON_ENTER_PAGE_HOOK=1595BCE0

-Z(CODE)PATCH_Feedback_DrawCoverArt=14C60818
-Z(CODE)PATCH_Feedback_RemoveIcon=14EC1F68

-Z(CODE)PATCH_Equalizer_EnterEvent=1595BD80
-Z(CODE)PATCH_Equalizer_CancelEvent=1595BD90

-Z(CODE)PATCH_SetEqualizerGain=14F660D4
