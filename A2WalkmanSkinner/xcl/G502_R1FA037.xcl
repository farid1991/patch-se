-carm
-Z(CODE)CODE,DATA_C=121A0000

-Z(CODE)PATCH_ONCREATE_HOOK=115BD3C8
-Z(CODE)PATCH_ONCLOSE_HOOK=115BD3CC
-Z(CODE)PATCH_ONREDRAW_HOOK=115BD3D0
-Z(CODE)PATCH_MUSIC_KEYBOARD1=
-Z(CODE)PATCH_MUSIC_KEYBOARD2=

-Z(CODE)PATCH_UPDATE_ORIENTATION_HOOK=11604114

-Z(CODE)PATCH_UPDATE_LOOP_HOOK=115B8A90
-Z(CODE)PATCH_UPDATE_SHUFFLE_HOOK=115B8A64

-Z(CODE)PATCH_Walkman_SoftKeys=115B94F0
-Z(CODE)PATCH_StereoWidening=115BAEB4

-Z(CODE)PATCH_UI_MEDIAPLAYER_ON_NEW_TRACK_HOOK=11B65248
-Z(CODE)PATCH_UI_MEDIAPLAYER_AUDIO_PLAYING_TIME_EVENT_HOOK=11B65230
-Z(CODE)PATCH_UI_MEDIAPLAYER_CREATED_EVENT_HOOK=11B65210
-Z(CODE)PATCH_UI_MEDIAPLAYER_ON_ENTER_PAGE_HOOK=11B652A0

-Z(CODE)PATCH_START_TIMER=10900120
-Z(CODE)PATCH_START_TIMER_2=108FFFF0
-Z(CODE)PATCH_STOP_TIMER=10900044
-Z(CODE)PATCH_STOP_TIMER_2=109001D4

-Z(CODE)PATCH_Walkman_GUI=115BDEC4

-Z(CODE)PATCH_Feedback_DrawCoverArt=
-Z(CODE)PATCH_Feedback_RemoveIcon=
