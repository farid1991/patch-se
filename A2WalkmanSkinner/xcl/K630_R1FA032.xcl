//K630_R1FA032
-carm
-Z(CODE)CODE,DATA_C=12020000

-Z(CODE)PATCH_ONCREATE_HOOK=1155144C
-Z(CODE)PATCH_ONCLOSE_HOOK=11551450
-Z(CODE)PATCH_ONREDRAW_HOOK=11551454
-Z(CODE)PATCH_MUSIC_KEYBOARD1=1154C2B8
-Z(CODE)PATCH_MUSIC_KEYBOARD2=1154C7D8

-Z(CODE)PATCH_UPDATE_ORIENTATION_HOOK=11597D5C

-Z(CODE)PATCH_Walkman_GUI=11551F48
-Z(CODE)PATCH_Walkman_SoftKeys=1154D570
-Z(CODE)PATCH_Visualization=1154D838
-Z(CODE)PATCH_StereoWidening=1154EF40

-Z(CODE)PATCH_UPDATE_LOOP_HOOK=1154CB1C
-Z(CODE)PATCH_UPDATE_SHUFFLE_HOOK=1154CAF0

-Z(CODE)PATCH_UI_MEDIAPLAYER_ON_NEW_TRACK_HOOK=11AF60FC
-Z(CODE)PATCH_UI_MEDIAPLAYER_AUDIO_PLAYING_TIME_EVENT_HOOK=11AF60E4
-Z(CODE)PATCH_UI_MEDIAPLAYER_CREATED_EVENT_HOOK=11AF60C4
-Z(CODE)PATCH_UI_MEDIAPLAYER_ON_ENTER_PAGE_HOOK=11AF6154

-Z(CODE)PATCH_Feedback_DrawCoverArt=1159E04C
-Z(CODE)PATCH_Feedback_RemoveIcon=1159E560
