-carm
-Z(CODE)CODE,DATA_C=12225000

-Z(CODE)PATCH_ONCREATE_HOOK=115FE07C
-Z(CODE)PATCH_ONCLOSE_HOOK=115FE080
-Z(CODE)PATCH_ONREDRAW_HOOK=115FE084
-Z(CODE)PATCH_MUSIC_KEYBOARD1=115F9048
-Z(CODE)PATCH_MUSIC_KEYBOARD2=115F89F8

-Z(CODE)PATCH_Walkman_GUI=115FEB78
-Z(CODE)PATCH_Walkman_SoftKeys=115F9D98
-Z(CODE)PATCH_StereoWidening=115FBB10
-Z(CODE)PATCH_UPDATE_LOOP_HOOK=115F9388
-Z(CODE)PATCH_UPDATE_SHUFFLE_HOOK=115F935C
-Z(CODE)PATCH_UPDATE_ORIENTATION_HOOK=116461E0

-Z(CODE)PATCH_UI_MEDIAPLAYER_ON_NEW_TRACK_HOOK=11BB1450
-Z(CODE)PATCH_UI_MEDIAPLAYER_AUDIO_PLAYING_TIME_EVENT_HOOK=11BB1438
-Z(CODE)PATCH_UI_MEDIAPLAYER_CREATED_EVENT_HOOK=11BB1418
-Z(CODE)PATCH_UI_MEDIAPLAYER_ON_ENTER_PAGE_HOOK=11BB14A8

-Z(CODE)PATCH_Feedback_DrawCoverArt=1164CB14
-Z(CODE)PATCH_Feedback_RemoveIcon=1164C9E4

-Z(CODE)PATCH_Equalizer_EnterEvent=11BB1538
-Z(CODE)PATCH_Equalizer_CancelEvent=11BB1548

-Z(CODE)PATCH_SetEqualizerGain=115F87E0
