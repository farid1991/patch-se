//C903_R1GA028
-carm
-Z(CODE)CODE,DATA_C=15DB0000

-Z(CODE)PATCH_ONCREATE_HOOK=14DBDED4
-Z(CODE)PATCH_ONCLOSE_HOOK=14DBDED8
-Z(CODE)PATCH_ONREDRAW_HOOK=14DBDEDC

-Z(CODE)PATCH_MUSIC_KEYBOARD1=150BA4A8
-Z(CODE)PATCH_MUSIC_KEYBOARD2=150BA770

-Z(CODE)PATCH_UPDATE_ORIENTATION_HOOK=143A05D8
-Z(CODE)PATCH_UPDATE_ORIENTATION_HOOK_2=143A05B4
-Z(CODE)PATCH_UPDATE_ORIENTATION_HOOK_3=143A05C8

-Z(CODE)PATCH_Walkman_GUI=150BA184
-Z(CODE)PATCH_Walkman_SoftKeys=14DA758C
-Z(CODE)PATCH_StereoWidening=14D93048
-Z(CODE)PATCH_UPDATE_LOOP_HOOK=14EE06A4
-Z(CODE)PATCH_UPDATE_SHUFFLE_HOOK=14EE0670

-Z(CODE)PATCH_UI_MEDIAPLAYER_ON_NEW_TRACK_HOOK=159DB66C
-Z(CODE)PATCH_UI_MEDIAPLAYER_AUDIO_PLAYING_TIME_EVENT_HOOK=159DB654
-Z(CODE)PATCH_UI_MEDIAPLAYER_CREATED_EVENT_HOOK=159DB62C
-Z(CODE)PATCH_UI_MEDIAPLAYER_ON_ENTER_PAGE_HOOK=159DB704

-Z(CODE)PATCH_Feedback_DrawCoverArt=14D68DF8
-Z(CODE)PATCH_Feedback_RemoveIcon=14EF55CC

-Z(CODE)PATCH_Equalizer_EnterEvent=159DB7A4
-Z(CODE)PATCH_Equalizer_CancelEvent=159DB7B4

-Z(CODE)PATCH_SetEqualizerGain=14E1E06C
