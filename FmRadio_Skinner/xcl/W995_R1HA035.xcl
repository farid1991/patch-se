-carm

-Z(CODE)CODE,DATA_C,INITTAB=121B2700

-Z(CODE)PATCH_FmRadio_OnCreate=15068090
-Z(CODE)PATCH_FmRadio_OnClose=15068094
-Z(CODE)PATCH_FmRadio_OnRedraw=15068098
-Z(CODE)PATCH_FmRadio_OnKey=1506809C
-Z(CODE)PATCH_FmRadio_NewRefresh=15068084

-Z(CODE)PATCH_FmRadio_NewSoftKey=
-Z(CODE)PATCH_FmRadio_UpdateSoftKey=

-Z(CODE)PATCH_Fix_FMRadio_Gui=
-Z(CODE)PATCH_FmRadio_LoadData=
-Z(CODE)PATCH_FmRadio_DeleteData=

-Z(CODE)PATCH_FmRadio_MainPage_Enter=15B91020
-Z(CODE)PATCH_FmRadio_Created=11B07DDC