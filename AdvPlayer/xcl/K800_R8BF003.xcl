//K800_R8BF003
-carm
-Z(CODE)CODE,DATA_C=45D9EB00
-Z(CODE)PATCH_MediaPlayer_Audio_OnCreate=4503E8D4
-Z(CODE)PATCH_MediaPlayer_Audio_OnClose=4503E8D8
-Z(CODE)PATCH_MediaPlayer_Audio_OnRedraw=4503E8DC
-Z(CODE)PATCH_MediaPlayer_Audio_SetStyle=4503E100

-Z(CODE)PATCH_AudioPlayerBook_onClose=45041108

-Z(CODE)PATCH_MediaPlayer_NowPlaying_OnCreate=4503F670
-Z(CODE)PATCH_MediaPlayer_NowPlaying_OnClose=4503F674
-Z(CODE)PATCH_MediaPlayer_NowPlaying_OnRedraw=4503F678
-Z(CODE)PATCH_MediaPlayer_NowPlaying_SetSize=4503E338

-Z(CODE)PATCH_MediaPlayer_PlayQueue_SetTitle=4503DFE8
-Z(CODE)PATCH_MediaPlayer_PlayQueue_SetStyle=4503E1B4
-Z(CODE)PATCH_MediaPlayer_PlayQueue_RemoveStyle=4503E1CC
-Z(CODE)PATCH_MediaPlayer_ScrollText_SetSize=

-Z(CODE)PATCH_GUI_MEDIAPLAYER=4503FBE0
-Z(CODE)PATCH_GUI_PLAYMODE=45046360
-Z(CODE)PATCH_GUI_STEREOWIDENING=45046550

-Z(CODE)PATCH_UI_MEDIAPLAYER_CREATED_EVENT=45B83884
-Z(CODE)PATCH_UI_MEDIAPLAYER_NEW_TRACK_EVENT=45B837F4
-Z(CODE)PATCH_UI_MEDIAPLAYER_AUDIO_PLAYING_TIME_EVENT=45B837EC

-Z(CODE)PATCH_MediaPlayer_SoftKeys=45041740
-Z(CODE)PATCH_MediaPlayer_SoftKeys_MyMusic=4504169C
-Z(CODE)PATCH_Toplevel_Bk_NowPlaying_PreviousEvent=45C214D4
-Z(CODE)PATCH_GUI_TOPLEVEL_ACTION_BACK=45344B78

-Z(CODE)PATCH_MEDIAPLAYER_MENU=4504C740

-Z(CODE)PATCH_GUI_MM_BROWSER_STYLE=45344EE4
-Z(CODE)PATCH_GUI_MM_BROWSER_LISTCOUNT=45344EC4
-Z(CODE)PATCH_GUI_MM_BROWSER_LISTTEXT=45344FE0
-Z(CODE)PATCH_GUI_MM_BROWSER_LISTICON=45344FF0
-Z(CODE)PATCH_GUI_MM_BROWSER_LISTLINK=45344C30
-Z(CODE)PATCH_GUI_MM_BROWSER_ONLINE_LINK=45344A98
-Z(CODE)PATCH_GUI_MM_ARTIST=453413E0
-Z(CODE)PATCH_GUI_MM_ALBUM=45340288
-Z(CODE)PATCH_GUI_MM_PLAYLIST1=45343A60
-Z(CODE)PATCH_GUI_MM_PLAYLIST2=453442B8
-Z(CODE)PATCH_GUI_MM_TRACKS1=45345D68
-Z(CODE)PATCH_GUI_MM_TRACKS2=453458BC
-Z(CODE)PATCH_GUI_MM_NOSTYLE=45342CF8
-Z(CODE)PATCH_FIX_TITLE=45342CCC
