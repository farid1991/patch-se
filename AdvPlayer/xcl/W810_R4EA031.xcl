//W810_R4EA031
-carm
-Z(CODE)CODE,DATA_C=457AF5D0
-Z(CODE)PATCH_UI_MEDIAPLAYER_AUDIO_PLAYING_TIME_EVENT=445015F0
-Z(CODE)PATCH_UI_MEDIAPLAYER_NEW_TRACK_EVENT=445015F8
-Z(CODE)PATCH_UI_MEDIAPLAYER_CREATED_EVENT=44501658

-Z(CODE)PATCH_MediaPlayer_Audio_SetStyle=45256010
-Z(CODE)PATCH_MediaPlayer_Audio_OnCreate=452567FC
-Z(CODE)PATCH_MediaPlayer_Audio_OnClose=45256800
-Z(CODE)PATCH_MediaPlayer_Audio_OnRedraw=45256804
-Z(CODE)PATCH_MediaPlayer_PlayQueue_SetTitle=45255EEC
-Z(CODE)PATCH_MediaPlayer_PlayQueue_SetStyle=452560DC
-Z(CODE)PATCH_MediaPlayer_PlayQueue_RemoveStyle=45256104
-Z(CODE)PATCH_MediaPlayer_ScrollText_SetSize=45256164
-Z(CODE)PATCH_MediaPlayer_Volume_SetPosition=4525620C
-Z(CODE)PATCH_MediaPlayer_NowPlaying_SetSize=4525629C

-Z(CODE)PATCH_MediaPlayer_NowPlaying_OnCreate=45257510
-Z(CODE)PATCH_MediaPlayer_NowPlaying_OnClose=45257514
-Z(CODE)PATCH_MediaPlayer_NowPlaying_OnRedraw=45257518

-Z(CODE)PATCH_AudioPlayerBook_onClose=45430C38
-Z(CODE)PATCH_MediaPlayer_SoftKeys=454313B4
-Z(CODE)PATCH_MediaPlayer_SoftKeys_Minimize=45431228

-Z(CODE)PATCH_SKIN_SELECTOR_TEXT=45431418
-Z(CODE)PATCH_SKIN_SELECTOR_LINK=45431610
-Z(CODE)PATCH_GUI_PLAYMODE=4543590C

-Z(CODE)PATCH_Toplevel_Bk_NowPlaying_PreviousEvent=445485FC
-Z(CODE)PATCH_MEDIAPLAYER_MENU=4543AFA8

-Z(CODE)PATCH_GUI_TOPLEVEL_STYLE=4552D214
-Z(CODE)PATCH_GUI_TOPLEVEL_ACTION_BACK=4552EE48
-Z(CODE)PATCH_GUI_MM_BROWSER_STYLE=4552F10C
-Z(CODE)PATCH_GUI_MM_BROWSER_LISTCOUNT=4552F0EC
-Z(CODE)PATCH_GUI_MM_BROWSER_LISTTEXT=4552F1CC
-Z(CODE)PATCH_GUI_MM_BROWSER_LISTICON=4552F1E0
-Z(CODE)PATCH_GUI_MM_BROWSER_LISTLINK=4552EEB8
-Z(CODE)PATCH_GUI_MM_ARTIST=4552BE38
-Z(CODE)PATCH_GUI_MM_ALBUM=4552AE40
-Z(CODE)PATCH_GUI_MM_TRACKS1=4552FDB0
-Z(CODE)PATCH_GUI_MM_TRACKS2=4552F8FC
-Z(CODE)PATCH_GUI_MM_PLAYLIST=4552DFE4
