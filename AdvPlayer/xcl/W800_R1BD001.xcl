//W800_R1BD001
-carm
-Z(CODE)CODE,DATA_C=45204100
-Z(CODE)PATCH_UI_MEDIAPLAYER_AUDIO_PLAYING_TIME_EVENT=442416D8
-Z(CODE)PATCH_UI_MEDIAPLAYER_NEW_TRACK_EVENT=442416E0
-Z(CODE)PATCH_UI_MEDIAPLAYER_CREATED_EVENT=44241740

-Z(CODE)PATCH_MediaPlayer_Audio_SetStyle=44E2C974
-Z(CODE)PATCH_MediaPlayer_Audio_OnCreate=44E2D4EC
-Z(CODE)PATCH_MediaPlayer_Audio_OnClose=44E2D4F0
-Z(CODE)PATCH_MediaPlayer_Audio_OnRedraw=44E2D4F4
-Z(CODE)PATCH_MediaPlayer_PlayQueue_SetTitle=44E2C83C
-Z(CODE)PATCH_MediaPlayer_PlayQueue_SetStyle=44E2CAA0
-Z(CODE)PATCH_MediaPlayer_PlayQueue_RemoveStyle=44E2CAD0
-Z(CODE)PATCH_MediaPlayer_ScrollText_SetSize=44E2CB30
-Z(CODE)PATCH_MediaPlayer_Volume_SetPosition=44E2CCDC
-Z(CODE)PATCH_MediaPlayer_NowPlaying_SetSize=44E2CD80

-Z(CODE)PATCH_MediaPlayer_NowPlaying_OnCreate=44E2E6DC
-Z(CODE)PATCH_MediaPlayer_NowPlaying_OnClose=44E2E6E0
-Z(CODE)PATCH_MediaPlayer_NowPlaying_OnRedraw=44E2E6E4

-Z(CODE)PATCH_SKIN_SELECTOR_TEXT1=44F5D66C
-Z(CODE)PATCH_SKIN_SELECTOR_TEXT2=44F5D678
-Z(CODE)PATCH_SKIN_SELECTOR_LINK=44F5D85C

-Z(CODE)PATCH_GUI_PLAYMODE=44F62278

-Z(CODE)PATCH_GUI_TOPLEVEL_STYLE=4504F3F0
-Z(CODE)PATCH_GUI_MM_BROWSER_STYLE=450519EC
-Z(CODE)PATCH_GUI_MM_BROWSER_LISTCOUNT=450519CC
-Z(CODE)PATCH_GUI_MM_BROWSER_LISTTEXT=45051AE0
-Z(CODE)PATCH_GUI_MM_BROWSER_LISTICON=45051AF0
-Z(CODE)PATCH_GUI_MM_BROWSER_LISTLINK=450516D4
-Z(CODE)PATCH_GUI_MM_ARTIST=4504DD18
-Z(CODE)PATCH_GUI_MM_ALBUM=4504CBF8
-Z(CODE)PATCH_GUI_MM_TRACKS1=45052A6C
-Z(CODE)PATCH_GUI_MM_TRACKS2=4505245C
