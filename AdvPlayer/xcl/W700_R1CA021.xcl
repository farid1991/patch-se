//W700_R1CA021
-carm
-Z(CODE)CODE,DATA_C=451ED000
-Z(CODE)PATCH_UI_MEDIAPLAYER_AUDIO_PLAYING_TIME_EVENT=44241E88
-Z(CODE)PATCH_UI_MEDIAPLAYER_NEW_TRACK_EVENT=44241E90
-Z(CODE)PATCH_UI_MEDIAPLAYER_CREATED_EVENT=44241EF0

-Z(CODE)PATCH_MediaPlayer_Audio_SetStyle=44E32B04
-Z(CODE)PATCH_MediaPlayer_Audio_OnCreate=44E3367C
-Z(CODE)PATCH_MediaPlayer_Audio_OnClose=44E33680
-Z(CODE)PATCH_MediaPlayer_Audio_OnRedraw=44E33684
-Z(CODE)PATCH_MediaPlayer_PlayQueue_SetTitle=44E329CC
-Z(CODE)PATCH_MediaPlayer_PlayQueue_SetStyle=44E32C30
-Z(CODE)PATCH_MediaPlayer_PlayQueue_RemoveStyle=44E32C60
-Z(CODE)PATCH_MediaPlayer_ScrollText_SetSize=44E32CC0
-Z(CODE)PATCH_MediaPlayer_Volume_SetPosition=44E32E6C
-Z(CODE)PATCH_MediaPlayer_NowPlaying_SetSize=44E32F10

-Z(CODE)PATCH_MediaPlayer_NowPlaying_OnCreate=44E3486C
-Z(CODE)PATCH_MediaPlayer_NowPlaying_OnClose=44E34870
-Z(CODE)PATCH_MediaPlayer_NowPlaying_OnRedraw=44E34874

-Z(CODE)PATCH_MediaPlayer_SoftKeys=44F64B1C
-Z(CODE)PATCH_MediaPlayer_SoftKeys_Minimize=44F64990

-Z(CODE)PATCH_AudioPlayerBook_onClose=44F64318

-Z(CODE)PATCH_SKIN_SELECTOR_TEXT1=44F64B90
-Z(CODE)PATCH_SKIN_SELECTOR_TEXT2=44F64B9C
-Z(CODE)PATCH_SKIN_SELECTOR_LINK=44F64D78

-Z(CODE)PATCH_Toplevel_Bk_NowPlaying_PreviousEvent=44287D34
-Z(CODE)PATCH_MEDIAPLAYER_MENU=44F6EFF4

-Z(CODE)PATCH_GUI_PLAYMODE=44F6978C
-Z(CODE)PATCH_GUI_TOPLEVEL_ACTION_BACK=45058244
-Z(CODE)PATCH_GUI_TOPLEVEL_STYLE=45056018
-Z(CODE)PATCH_GUI_MM_BROWSER_STYLE=45058620
-Z(CODE)PATCH_GUI_MM_BROWSER_LISTCOUNT=45058600
-Z(CODE)PATCH_GUI_MM_BROWSER_LISTTEXT=45058714
-Z(CODE)PATCH_GUI_MM_BROWSER_LISTICON=45058724
-Z(CODE)PATCH_GUI_MM_BROWSER_LISTLINK=45058308
-Z(CODE)PATCH_GUI_MM_ARTIST=45054940
-Z(CODE)PATCH_GUI_MM_ALBUM=45053820
-Z(CODE)PATCH_GUI_MM_TRACKS1=450596A4
-Z(CODE)PATCH_GUI_MM_TRACKS2=45059094
-Z(CODE)PATCH_GUI_MM_PLAYLIST=4552DFE4
