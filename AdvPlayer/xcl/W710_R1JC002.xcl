//W710_R1JC002
-carm
-Z(CODE)CODE,DATA_C,INITTAB=45B00000
-Z(CODE)PATCH_UI_MEDIAPLAYER_AUDIO_PLAYING_TIME_EVENT=4599AC40
-Z(CODE)PATCH_UI_MEDIAPLAYER_NEW_TRACK_EVENT=4599AC48
-Z(CODE)PATCH_UI_MEDIAPLAYER_CREATED_EVENT=4599AD00

-Z(CODE)PATCH_AudioPlayerBook_onClose=44F1E5B0

-Z(CODE)PATCH_MediaPlayer_Audio_OnCreate=44F1B5DC
-Z(CODE)PATCH_MediaPlayer_Audio_OnClose=44F1B5E0
-Z(CODE)PATCH_MediaPlayer_Audio_OnRedraw=44F1B5E4
-Z(CODE)PATCH_MediaPlayer_Audio_SetStyle=44F1AD9C
-Z(CODE)PATCH_MediaPlayer_NowPlaying_OnCreate=44F1C9C8
-Z(CODE)PATCH_MediaPlayer_NowPlaying_OnClose=44F1C9CC
-Z(CODE)PATCH_MediaPlayer_NowPlaying_OnRedraw=44F1C9D0
-Z(CODE)PATCH_MediaPlayer_NowPlaying_SetSize=44F1B028
-Z(CODE)PATCH_MediaPlayer_PlayQueue_SetTitle=44F1AC80
-Z(CODE)PATCH_MediaPlayer_PlayQueue_SetStyle=44F1AE58
-Z(CODE)PATCH_MediaPlayer_PlayQueue_RemoveStyle=44F1AE70
-Z(CODE)PATCH_MediaPlayer_ScrollText_SetSize=44F1AED4

-Z(CODE)PATCH_MediaPlayer_SoftKeys=44F1EBF8
-Z(CODE)PATCH_MediaPlayer_SoftKeys_MyMusic=44F1EBB8
-Z(CODE)PATCH_Toplevel_Bk_NowPlaying_PreviousEvent=45A27B10
-Z(CODE)PATCH_GUI_TOPLEVEL_ACTION_BACK=45221BF4
-Z(CODE)PATCH_MEDIAPLAYER_MENU=44F29D5C

-Z(CODE)PATCH_GUI_PLAYMODE=44F23978

-Z(CODE)PATCH_GUI_MM_BROWSER_STYLE=45221F90
-Z(CODE)PATCH_GUI_MM_BROWSER_LISTCOUNT=45221F70
-Z(CODE)PATCH_GUI_MM_BROWSER_LISTTEXT=45222040
-Z(CODE)PATCH_GUI_MM_BROWSER_LISTICON=45222050
-Z(CODE)PATCH_GUI_MM_BROWSER_LISTLINK=45221CB0
-Z(CODE)PATCH_GUI_MM_BROWSER_ONLINE_LINK=45221B14
-Z(CODE)PATCH_GUI_MM_ARTIST=4521E0F0
-Z(CODE)PATCH_GUI_MM_ALBUM=4521CE2C
-Z(CODE)PATCH_GUI_MM_PLAYLIST1=45220980
-Z(CODE)PATCH_GUI_MM_PLAYLIST2=452212B8
-Z(CODE)PATCH_GUI_MM_TRACKS1=45222ED4
-Z(CODE)PATCH_GUI_MM_TRACKS2=452229E0
-Z(CODE)PATCH_FIX_TITLE=4521FAE4
