//W710_R1JC002
-carm
-Z(CODE)CODE,DATA_C,INITTAB=45B00000
-Z(CODE)PATCH_UI_MEDIAPLAYER_AUDIO_PLAYING_TIME_EVENT=4599AC40
-Z(CODE)PATCH_UI_MEDIAPLAYER_NEW_TRACK_EVENT=4599AC48
-Z(CODE)PATCH_UI_MEDIAPLAYER_CREATED_EVENT=4599AD00

-Z(CODE)PATCH_MediaPlayer_Audio_OnCreate=44F1B5DC
-Z(CODE)PATCH_MediaPlayer_Audio_OnClose=44F1B5E0
-Z(CODE)PATCH_MediaPlayer_Audio_OnRedraw=44F1B5E4
-Z(CODE)PATCH_MediaPlayer_Audio_SetStyle=44F1AD9C
-Z(CODE)PATCH_MediaPlayer_NowPlaying_OnCreate=44F1C9C8
-Z(CODE)PATCH_MediaPlayer_NowPlaying_OnClose=44F1C9CC
-Z(CODE)PATCH_MediaPlayer_NowPlaying_OnRedraw=44F1C9D0
-Z(CODE)PATCH_MediaPlayer_NowPlaying_SetSize=44F1B028
-Z(CODE)PATCH_MediaPlayer_PlayQueue_SetTitle=44F1AC80
-Z(CODE)PATCH_MediaPlayer_PlayQueue_SetStyle=44F1AE58
-Z(CODE)PATCH_MediaPlayer_PlayQueue_RemoveStyle=44F1AE70
-Z(CODE)PATCH_MediaPlayer_ScrollText_SetSize=44F1AED4

-Z(CODE)PATCH_SKIN_SELECTOR=44F1EBF8
